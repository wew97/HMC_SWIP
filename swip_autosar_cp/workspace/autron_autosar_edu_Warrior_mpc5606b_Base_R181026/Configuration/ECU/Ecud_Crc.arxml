AUTOSAR XML (schema 4-0-3)
package /AUTOSAR
  module config Crc: implementation-config-variant=VARIANT-PRE-COMPILE, module-description=BswImplementation_Crc
    CrcGeneral: Crc16Mode=CRC_16_RUNTIME, Crc32Mode=CRC_32_RUNTIME, Crc8H2FMode=CRC_8H2F_RUNTIME, Crc8Mode=CRC_8_RUNTIME
