AUTOSAR XML (schema 4-0-3)
package /AUTRON
  module config OsProfiler: implementation-config-variant=VARIANT-PRE-COMPILE, module-description=BswImplementation_OsProfiler
    OsProfilerGlobalConfig: EnableProfileIsr=1, ProfileEventCount=20, TimeIndexPeriod=0.005, EnableTimeIndex=1, EnableOsProfiler=1
    5 x OsProfilerPeriodTaskConfig:
      OsTask_BSW_FG1_5ms_Com: PeriodTaskRef=OsTask_BSW_FG1_5ms_Com
      OsTask_BSW_FG1_5ms_Mem: PeriodTaskRef=OsTask_BSW_FG1_5ms_Mem
      OsTask_BSW_FG1_10ms: PeriodTaskRef=OsTask_BSW_FG1_10ms
      OsTask_ASW_FG1_10ms: PeriodTaskRef=OsTask_ASW_FG1_10ms
      OsTask_ASW_FG1_100ms: PeriodTaskRef=OsTask_ASW_FG1_100ms
    OsProfilerTargetConfig: TargetOperatingSystem=FREESCALE_MPC560xB, XOSC=8
