AUTOSAR XML (schema 4-0-3)
package /Mcu
  module config Mcu: implementation-config-variant=VARIANT-POST-BUILD, module-description=BswImplementation_Mcu
    NonAutosar: McuGetDeviceInfoApi=0, McuDisableDemReportErrorStatus=1, McuSscmGetSystemStatus=0, McuSscmGetMemConfig=0
    McuGeneralConfiguration:
      McuDevErrorDetect = 1
      McuGetRamStateApi = 0
      McuInitClock = 1
      McuNoPll = 0
      McuPerformResetApi = 1
      McuCalloutBeforePerformReset = 0
      McuPerformResetCallout = NULL_PTR
      McuVersionInfoApi = 0
      McuConfigureFlash = 1
      McuDmaInit = 1
      McuLPTransitionCheck = 1
      McuEnterLowPowerMode = 1
      McuSkipFunction = 0
      McueMiosConfigureGPRENApi = 0
      McuEnableDisableNotificationApi = 0
      McuNotification = NULL_PTR
      McuConfClkOutput = 1
      McuSscmPAE = 1
      McuSscmRAE = 1
      McuDisablePeripheralDuringInitclock = 1
    McuModuleConfiguration_0 (McuModuleConfiguration): McuClockSrcFailureNotification=DISABLED, McuNumberOfMcuModes=3, McuRamSectors=1, FrequencyOfFXOSC=8000000.0, McuTimeout=4294967294
      McuEnableMode: McuModeStop=1, McuModeSTBY=1, McuModeHalt=1, McuModeRun3=1, McuModeRun2=1, McuModeRun1=1
      McuInterruptTransition: McuTransitionComplete=0, McuSafeMode=0, McuInvalidMode=0, McuInvalidConfiguration=0
      McuPowerDomain: McuPwrSTBY=1, McuPwrStop=1, McuPwrHalt=1, McuPwrRun3=1, McuPwrRun2=1, McuPwrRun1=1, McuPwrRun0=1, McuPwrDRun=1, McuPwrSafe=1
      McuDMAMUXandEDMAConfig:
        eDMAChannelPriority0 = 66051
        eDMAChannelPriority4 = 67438087
        eDMAChannelPriority8 = 134810123
        eDMAChannelPriority12 = 202182159
        EMLM = 0
        CLM = 0
        HALT = 0
        HOE = 0
        ERGA = 0
        ERCA = 0
        EDBG = 0
        EBW = 0
        GRP0PRI = 0
      McuFlashPFCR0:
        ReadWhileWriteControl = 7
        Port0PageBufferConfiguration = 3
        Port0DataPrefetchEnable = 0
        Port0InstructionPrefetchEnable = 1
        Port0PrefetchLimit = 2
        Port0BufferEnable = 1
      McuFlashPFCR1: ReadWhileWriteControl=7, Port0BufferEnable=1
      McuFlashPFAPR: Master0PrefetchDisable=1, Master2PrefetchDisable=1, Master0AccessProtection=3, Master2AccessProtection=3
      McuClockSettingConfig_PLL (McuClockSettingConfig): McuClockSettingId=1, McuSystemClockFrequency=6.4E7
        GeneralClockSettings:
          SystemClockSelect = McuPLL
          McuStartRunMode = RUN0
          McuOSC = 1
          McuPLLStatus = 1
          VoltageRegulator = 1
          McuCodeFlashStatus = NormalMode
          McuDataFlashStatus = NormalMode
          McuRC16MHzOscillator = 1
          McuOutputPowerDownControl = 0
        5 x McuClockReferencePoint:
          McuClockReferencePoint_PeripheralSet1clock: McuClockReferencePointFrequency=6.4E7, McuClockFrequencySelect=PeripheralSet0clock
          McuClockReferencePoint_PeripheralSet2clock: McuClockReferencePointFrequency=6.4E7, McuClockFrequencySelect=PeripheralSet1clock
          McuClockReferencePoint_PeripheralSet3clock: McuClockReferencePointFrequency=6.4E7, McuClockFrequencySelect=PeripheralSet2clock
          McuClockReferencePoint_SystemClockFrequency: McuClockReferencePointFrequency=6.4E7, McuClockFrequencySelect=SystemClockFrequency
          McuClockReferencePoint_IoHwAbTest: McuClockReferencePointFrequency=1.0E6, McuClockFrequencySelect=eMiosA_clk_freq
        McuXtal_A: McuXtalByPass=0, McuXtalCounterOscillator=200, McuXtalMaskInterrupt=0, McuXtalDivisor=1
        McuXtal_B_32KHz: McuXtalByPass=0, McuXtalCounterOscillator=100, McuXtalMaskInterrupt=0, McuXtalDivisor=1, McuXtalOn=0
        McuRC_16MHz: McuRCDivisor=1
        McuRC_128KHz: McuRCDivisor=1, McuRCStandBy=0
        McuClkOutput: McuClkOutput=1, McuClkDivisor=DIV_8, McuClkSource=PLL
        McuPll_0: McuPllMode_0=Normal
          McuPll0_Parameter:
            PLL_0_Frequency = 64000000
            McuOutputDivisionFactor = 4
            McuInputDivisionFactor = 3
            McuMultiplicationFactor = 96
            McuProgressiveClockSwitching = 0
            McuEnableFailInterrupt = 0
        McuEMIOSSettings_A: GlobalPrescaler=63, MdisBit=0, GlobalTimeBaseEnable=1, FreezeBit=1, GlobalPrescalerEnable=1
        McuEMIOSSettings_B: GlobalPrescaler=63, MdisBit=0, GlobalTimeBaseEnable=1, FreezeBit=1, GlobalPrescalerEnable=1
        McuPeripheralClkSet_{0..2}: McuPeripheralEnableClk=1, McuPeripheralDivisorFactor=1
        McuFlashPFCR0: AddressPipeliningControl=2, WriteWaitStateControl=2, ReadWaitStateControl=2
        McuFlashPFCR1: AddressPipeliningControl=2, WriteWaitStateControl=2, ReadWaitStateControl=2
      McuClockSettingConfig_QUARTZ (McuClockSettingConfig): McuClockSettingId=2, McuSystemClockFrequency=8000000.0
        GeneralClockSettings:
          SystemClockSelect = McuDivExtQuartzOsc
          McuStartRunMode = RUN2
          McuOSC = 1
          McuPLLStatus = 0
          VoltageRegulator = 1
          McuCodeFlashStatus = NormalMode
          McuDataFlashStatus = NormalMode
          McuRC16MHzOscillator = 1
          McuOutputPowerDownControl = 0
        McuClockReferencePoint_QUARTZ (McuClockReferencePoint): McuClockReferencePointFrequency=8000000.0, McuClockFrequencySelect=Xtal_A
        McuXtal_A: McuXtalByPass=0, McuXtalCounterOscillator=100, McuXtalMaskInterrupt=0, McuXtalDivisor=1
        McuXtal_B_32KHz: McuXtalByPass=0, McuXtalCounterOscillator=100, McuXtalMaskInterrupt=0, McuXtalDivisor=1, McuXtalOn=1
        McuRC_16MHz: McuRCDivisor=1
        McuRC_128KHz: McuRCDivisor=1, McuRCStandBy=0
        McuClkOutput: McuClkOutput=1, McuClkDivisor=DIV_1, McuClkSource=Crystal
        McuPll_0: McuPllMode_0=Normal
          McuPll0_Parameter:
            PLL_0_Frequency = 64000000
            McuOutputDivisionFactor = 4
            McuInputDivisionFactor = 3
            McuMultiplicationFactor = 96
            McuProgressiveClockSwitching = 0
            McuEnableFailInterrupt = 0
        McuEMIOSSettings_A: GlobalPrescaler=0, MdisBit=1, GlobalTimeBaseEnable=1, FreezeBit=0, GlobalPrescalerEnable=1
        McuEMIOSSettings_B: GlobalPrescaler=0, MdisBit=1, GlobalTimeBaseEnable=1, FreezeBit=0, GlobalPrescalerEnable=1
        McuPeripheralClkSet_{0..2}: McuPeripheralEnableClk=1, McuPeripheralDivisorFactor=1
        McuFlashPFCR0: AddressPipeliningControl=0, WriteWaitStateControl=0, ReadWaitStateControl=0
        McuFlashPFCR1: AddressPipeliningControl=0, WriteWaitStateControl=0, ReadWaitStateControl=0
      McuDemEventParameterRefs
      3 x McuModeSettingConf, all with McuVoltageRegulator=1, McuBootMode=0, McuOutputPowerDownControl=0, McuAuxiliaryClockSettings=0:
        McuModeSettingConf_PLL: McuMode=1, McuOperatingMode=RUN0, McuFastTransition=1, LowPowerClockSettingConfig=McuClockSettingConfig_PLL
        McuModeSettingConf_QUARTZ: McuMode=2, McuOperatingMode=RUN2, McuFastTransition=1, LowPowerClockSettingConfig=McuClockSettingConfig_QUARTZ
        McuModeSettingConf_HALT: McuMode=3, McuOperatingMode=HALT, McuFastTransition=0, LowPowerClockSettingConfig=McuClockSettingConfig_PLL
      McuRamSectorSettingConf_0 (McuRamSectorSettingConf): McuRamDefaultValue=186, McuRamSectionBaseAddress=1073741824, McuRamSectionSize=1024, McuRamSectionBaseAddrLinkerSym=, McuRamSectionSizeLinkerSym=
      McuDMA
        DSPI0_TX: DMAChannelId=0, McuDMASource=DSPI0_TX, DMAChannelEnable=0, DMAChannelTriggerEnable=0
        DSPI0_RX: DMAChannelId=1, McuDMASource=DSPI0_RX, DMAChannelEnable=0, DMAChannelTriggerEnable=0
        DSPI1_TX: DMAChannelId=2, McuDMASource=DSPI1_TX, DMAChannelEnable=0, DMAChannelTriggerEnable=0
        DSPI1_RX: DMAChannelId=3, McuDMASource=DSPI1_RX, DMAChannelEnable=0, DMAChannelTriggerEnable=0
        DSPI2_TX: DMAChannelId=4, McuDMASource=DSPI2_TX, DMAChannelEnable=0, DMAChannelTriggerEnable=0
        DSPI2_RX: DMAChannelId=5, McuDMASource=DSPI2_RX, DMAChannelEnable=0, DMAChannelTriggerEnable=0
        DSPI3_TX: DMAChannelId=6, McuDMASource=DSPI3_TX, DMAChannelEnable=0, DMAChannelTriggerEnable=0
        DSPI3_RX: DMAChannelId=7, McuDMASource=DSPI3_RX, DMAChannelEnable=0, DMAChannelTriggerEnable=0
        DSPI4_TX: DMAChannelId=8, McuDMASource=DSPI4_TX, DMAChannelEnable=0, DMAChannelTriggerEnable=0
        DSPI4_RX: DMAChannelId=9, McuDMASource=DSPI4_RX, DMAChannelEnable=0, DMAChannelTriggerEnable=0
        DSPI5_TX: DMAChannelId=10, McuDMASource=DSPI5_TX, DMAChannelEnable=0, DMAChannelTriggerEnable=0
        DSPI5_RX: DMAChannelId=11, McuDMASource=DSPI5_RX, DMAChannelEnable=0, DMAChannelTriggerEnable=0
        EMIOS0_CH0: DMAChannelId=12, McuDMASource=EMIOS0_CH0, DMAChannelEnable=0, DMAChannelTriggerEnable=0
        EMIOS0_CH1: DMAChannelId=13, McuDMASource=EMIOS0_CH1, DMAChannelEnable=0, DMAChannelTriggerEnable=0
        EMIOS0_CH9: DMAChannelId=14, McuDMASource=EMIOS0_CH9, DMAChannelEnable=0, DMAChannelTriggerEnable=0
        EMIOS0_CH18: DMAChannelId=15, McuDMASource=EMIOS0_CH18, DMAChannelEnable=0, DMAChannelTriggerEnable=0
        EMIOS0_CH25: DMAChannelId=16, McuDMASource=EMIOS0_CH25, DMAChannelEnable=0, DMAChannelTriggerEnable=0
        EMIOS0_CH26: DMAChannelId=17, McuDMASource=EMIOS0_CH26, DMAChannelEnable=0, DMAChannelTriggerEnable=0
        EMIOS1_CH0: DMAChannelId=18, McuDMASource=EMIOS1_CH0, DMAChannelEnable=0, DMAChannelTriggerEnable=0
        EMIOS1_CH9: DMAChannelId=19, McuDMASource=EMIOS1_CH9, DMAChannelEnable=0, DMAChannelTriggerEnable=0
        EMIOS1_CH17: DMAChannelId=20, McuDMASource=EMIOS1_CH17, DMAChannelEnable=0, DMAChannelTriggerEnable=0
        EMIOS1_CH18: DMAChannelId=21, McuDMASource=EMIOS1_CH18, DMAChannelEnable=0, DMAChannelTriggerEnable=0
        EMIOS1_CH25: DMAChannelId=22, McuDMASource=EMIOS1_CH25, DMAChannelEnable=0, DMAChannelTriggerEnable=0
        EMIOS1_CH26: DMAChannelId=23, McuDMASource=EMIOS1_CH26, DMAChannelEnable=0, DMAChannelTriggerEnable=0
        ADC0_EOC: DMAChannelId=24, McuDMASource=ADC0_EOC, DMAChannelEnable=0, DMAChannelTriggerEnable=0
        ADC1_EOC: DMAChannelId=25, McuDMASource=ADC1_EOC, DMAChannelEnable=0, DMAChannelTriggerEnable=0
        IIC_RX: DMAChannelId=26, McuDMASource=IIC_RX, DMAChannelEnable=0, DMAChannelTriggerEnable=0
        IIC_TX: DMAChannelId=27, McuDMASource=IIC_TX, DMAChannelEnable=0, DMAChannelTriggerEnable=0
        LINFLEXD0_RX: DMAChannelId=28, McuDMASource=LINFLEXD0_RX, DMAChannelEnable=0, DMAChannelTriggerEnable=0
        LINFLEXD0_TX: DMAChannelId=29, McuDMASource=LINFLEXD0_TX, DMAChannelEnable=0, DMAChannelTriggerEnable=0
        LINFLEXD1_RX: DMAChannelId=30, McuDMASource=LINFLEXD1_RX, DMAChannelEnable=0, DMAChannelTriggerEnable=0
        LINFLEXD1_TX: DMAChannelId=31, McuDMASource=LINFLEXD1_TX, DMAChannelEnable=0, DMAChannelTriggerEnable=0
        ALWAYS_ENABLED_0: DMAChannelId=32, McuDMASource=ALWAYS_ENABLED_0, DMAChannelEnable=0, DMAChannelTriggerEnable=0
        ALWAYS_ENABLED_1: DMAChannelId=33, McuDMASource=ALWAYS_ENABLED_1, DMAChannelEnable=0, DMAChannelTriggerEnable=0
        ALWAYS_ENABLED_2: DMAChannelId=34, McuDMASource=ALWAYS_ENABLED_2, DMAChannelEnable=0, DMAChannelTriggerEnable=0
        ALWAYS_ENABLED_3: DMAChannelId=35, McuDMASource=ALWAYS_ENABLED_3, DMAChannelEnable=0, DMAChannelTriggerEnable=0
      8 x McuRunConfig, all with McuModeRun3=1, McuModeRun2=1, McuModeRun1=1, McuModeRun0=1, McuModeDRun=1, McuModeSafe=1:
        McuRunConfig_{0..7}
      8 x McuLowPower, all with McuSTBY=0:
        McuLowPower_0: McuStop=0, McuHalt=1
        McuLowPower_1: McuStop=1, McuHalt=1
        McuLowPower_{2..7}: McuStop=0, McuHalt=0
      McuPeriphal
        DSPI{0..5}: McuPerRunConfig=McuRunConfig_0, McuPerLowPwrConfig=McuLowPower_0
        LIN_FLEX8: McuPerRunConfig=McuRunConfig_0, McuPerLowPwrConfig=McuLowPower_0
        LIN_FLEX9: McuPerRunConfig=McuRunConfig_0, McuPerLowPwrConfig=McuLowPower_0
        FlexCAN{0..5}: McuPerRunConfig=McuRunConfig_0, McuPerLowPwrConfig=McuLowPower_0
        DMA_CH_MUX: McuPerRunConfig=McuRunConfig_0, McuPerLowPwrConfig=McuLowPower_0
        ADC0: McuPerRunConfig=McuRunConfig_0, McuPerLowPwrConfig=McuLowPower_0
        ADC1: McuPerRunConfig=McuRunConfig_0, McuPerLowPwrConfig=McuLowPower_0
        I2C0: McuPerRunConfig=McuRunConfig_0, McuPerLowPwrConfig=McuLowPower_0
        LIN_FLEX{0..7}: McuPerRunConfig=McuRunConfig_0, McuPerLowPwrConfig=McuLowPower_0
        CTU: McuPerRunConfig=McuRunConfig_0, McuPerLowPwrConfig=McuLowPower_0
        CANSampler: McuPerRunConfig=McuRunConfig_0, McuPerLowPwrConfig=McuLowPower_0
        SIUL: McuPerRunConfig=McuRunConfig_0, McuPerLowPwrConfig=McuLowPower_1
        WKPU: McuPerRunConfig=McuRunConfig_0, McuPerLowPwrConfig=McuLowPower_1
        eMIOS0: McuPerRunConfig=McuRunConfig_0, McuPerLowPwrConfig=McuLowPower_0
        eMIOS1: McuPerRunConfig=McuRunConfig_0, McuPerLowPwrConfig=McuLowPower_0
        RTC_API: McuPerRunConfig=McuRunConfig_0, McuPerLowPwrConfig=McuLowPower_1
        PIT_RTI: McuPerRunConfig=McuRunConfig_0, McuPerLowPwrConfig=McuLowPower_0
        CMU0: McuPerRunConfig=McuRunConfig_0, McuPerLowPwrConfig=McuLowPower_0
      McuResetSource
        JTAG: McuEnableReset=1, McuEnableInterrupt=0, McuResetPhase=PHASE_1, McuResetPin=0
        CORE: McuEnableReset=1, McuEnableInterrupt=0, McuResetPhase=PHASE_1, McuResetPin=0
        SOFT: McuEnableReset=1, McuEnableInterrupt=0, McuResetPhase=PHASE_1, McuResetPin=0
        CHKSTOP: McuEnableReset=1, McuEnableInterrupt=0, McuResetPhase=PHASE_1, McuResetPin=0
        PLL: McuEnableReset=1, McuEnableInterrupt=0, McuResetPhase=PHASE_1, McuResetPin=0
        CMU0_OLR: McuEnableReset=1, McuEnableInterrupt=0, McuResetPhase=PHASE_1, McuResetPin=0
        CMU0_FHL: McuEnableReset=1, McuEnableInterrupt=0, McuResetPhase=PHASE_1, McuResetPin=0
        LVD45: McuEnableReset=1, McuEnableInterrupt=0, McuResetPhase=PHASE_1, McuResetPin=0
        FLASH: McuEnableReset=1, McuEnableInterrupt=0, McuResetPhase=PHASE_1, McuResetPin=0
        EXR: McuEnableReset=1, McuEnableInterrupt=0, McuResetPhase=PHASE_1, McuResetPin=0
        LVD12PD0: McuEnableReset=1, McuEnableInterrupt=0, McuResetPhase=PHASE_1, McuResetPin=0
        LVD12PD1: McuEnableReset=1, McuEnableInterrupt=0, McuResetPhase=PHASE_1, McuResetPin=0
        SWT: McuEnableReset=1, McuEnableInterrupt=0, McuResetPhase=PHASE_1, McuResetPin=0
        LVD27: McuEnableReset=1, McuEnableInterrupt=0, McuResetPhase=PHASE_1, McuResetPin=0
        LVD27_VREG: McuEnableReset=1, McuEnableInterrupt=0, McuResetPhase=PHASE_1, McuResetPin=0
    McuPublishedInformation
      17 x McuResetReasonConf:
        MCU_POWER_ON_RESET: McuResetReason=0
        MCU_WATCHDOG_RESET: McuResetReason=1
        MCU_SW_RESET: McuResetReason=2
        MCU_RESET_UNDEFINED: McuResetReason=3
        MCU_2_7_LOW_VOLTAGE: McuResetReason=4
        MCU_2_7_LV_VREG_RESET: McuResetReason=5
        MCU_1_2_LV_PW_DOMAIN_0: McuResetReason=6
        MCU_1_2_LV_PW_DOMAIN_1: McuResetReason=7
        MCU_EXR_RESET: McuResetReason=8
        MCU_JTAG_RESET: McuResetReason=9
        MCU_CORE_RESET: McuResetReason=10
        MCU_CHECKSTOP_RESET: McuResetReason=11
        MCU_PLL0_RESET: McuResetReason=12
        MCU_CMU_OLR_RESET: McuResetReason=13
        MCU_CMU_FHL_RESET: McuResetReason=14
        MCU_4_5_LOW_VOLTAGE: McuResetReason=15
        MCU_FLASH_RESET: McuResetReason=16
    CommonPublishedInformation:
      ArReleaseMajorVersion = 4
      ArReleaseMinorVersion = 0
      ArReleaseRevisionVersion = 3
      ModuleId = 101
      SwMajorVersion = 1
      SwMinorVersion = 0
      SwPatchVersion = 1
      VendorId = 43
