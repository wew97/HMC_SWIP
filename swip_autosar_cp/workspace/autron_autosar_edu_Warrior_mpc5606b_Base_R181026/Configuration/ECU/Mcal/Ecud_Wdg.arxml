AUTOSAR XML (schema 4-0-3)
package /Wdg
  module config Wdg: implementation-config-variant=VARIANT-PRE-COMPILE, module-description=BswImplementation_Wdg_43
    NonAutosar: WdgDisableDemReportErrorStatus=0
    WdgDemEventParameterRefs: WDG_E_DISABLE_REJECTED=WDG_E_DISABLE_REJECTED, WDG_E_MODE_FAILED=WDG_E_MODE_FAILED, WDG_E_MISS_TRIGGER=WDG_E_MISS_TRIGGER
    WdgGeneral:
      WdgDevErrorDetect = 1
      WdgDisableAllowed = 1
      WdgMasterAccessProtection = ALL_MAPx
      WdgIndex = 0
      WdgInitialTimeout = 0.2
      WdgMaxTimeout = 4.2
      WdgRunArea = ROM
      WdgCallbackNotification0 = RE_Wdg_Cbk
      WdgTriggerLocation = pointer
      WdgVersionInfoApi = 1
    WdgPublishedInformation: WdgTriggerMode=WDG_TOGGLE
    WdgSettingsConfig: WdgInstance=SWT0, WdgDefaultMode=WDGIF_SLOW_MODE, WdgKeyedService=0, WdgServiceKeyValue=0, WdgExternalTriggerCounterRef=GptChannelConfiguration_Wdg
      WdgSettingsFast:
        category = TOOL_CONFIGURED
        WdgReadOnly = 0
        WdgHardLock = 0
        WdgWindowMode = 0
        WdgRunsInStopMode = 0
        WdgRunsInDebugMode = 0
        WdgOperationMode = ResetOnTimeOut
        WdgResetOnInvalidAccess = SystemReset
        WdgClockSelection = OscillatorClock
        WdgTimeoutPeriod = 0.02
        WdgWindowPeriod = 0.02
      WdgSettingsOff: category=TOOL_CONFIGURED, WdgReadOnly=0, WdgHardLock=0
      WdgSettingsSlow:
        category = TOOL_CONFIGURED
        WdgReadOnly = 0
        WdgHardLock = 0
        WdgWindowMode = 0
        WdgRunsInStopMode = 1
        WdgRunsInDebugMode = 0
        WdgOperationMode = ResetOnTimeOut
        WdgResetOnInvalidAccess = SystemReset
        WdgClockSelection = OscillatorClock
        WdgTimeoutPeriod = 0.1
        WdgWindowPeriod = 0.1
    CommonPublishedInformation:
      ArReleaseMajorVersion = 4
      ArReleaseMinorVersion = 0
      ArReleaseRevisionVersion = 3
      ModuleId = 102
      SwMajorVersion = 1
      SwMinorVersion = 0
      SwPatchVersion = 1
      VendorId = 43
