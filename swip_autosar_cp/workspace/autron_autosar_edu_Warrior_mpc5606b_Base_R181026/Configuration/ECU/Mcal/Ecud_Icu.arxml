AUTOSAR XML (schema 4-0-3)
package /Icu
  module config Icu: implementation-config-variant=VARIANT-POST-BUILD, module-description=BswImplementation_Icu_43
    IcuConfigSet_0 (IcuConfigSet): IcuMaxChannel=3, IcuDmaMaxChannel=0, IcuEXT_ISR_IFCPRDigitalFilter=0, IcuEXT_ISRaltIFCPRDigitalFilter=0
      3 x IcuChannel, all with Icu_EXT_ISR_IFERDigitalFilter=0, Icu_EXT_ISR_IFMCDigitalFilter=0, IcuWKPU_ISR_WIPUER=0, IcuEmiosFreeze=0, IcuEmiosPrescaler=EMIOS_PRESCALER_DIVIDE_1, IcuEmiosPrescaler_Alternate=EMIOS_PRESCALER_DIVIDE_1, IcuEmiosDigitalFilter=EMIOS_DIGITAL_FILTER_BYPASSED, IcuEmiosBusSelect=EMIOS_BUS_INTERNAL_COUNTER, IcuDMAEnable=0, IcuUserModeForDutycycle=SAIC, IcuOverflowNotification=NULL_PTR, IcuWakeupCapability=0, IcuSignalMeasureWithoutInterrupt=0, IcuDisableEcumWakeupSourceNotification=0:
        IcuChannel_EdgeCounter: IcuChannelId=0, IcuHwChannel=EMIOS_0_CH_6, IcuDefaultStartEdge=ICU_FALLING_EDGE, IcuMeasurementMode=ICU_MODE_EDGE_COUNTER
        IcuChannel_SignalMeasurement: IcuChannelId=1, IcuHwChannel=EMIOS_0_CH_7, IcuDefaultStartEdge=ICU_RISING_EDGE, IcuMeasurementMode=ICU_MODE_SIGNAL_MEASUREMENT
          IcuSignalMeasurement: IcuSignalMeasurementProperty=ICU_DUTY_CYCLE
        IcuChannel_Timestamp: IcuChannelId=2, IcuHwChannel=EMIOS_0_CH_8, IcuDefaultStartEdge=ICU_RISING_EDGE, IcuMeasurementMode=ICU_MODE_TIMESTAMP
          IcuTimestampMeasurement: IcuTimestampMeasurementProperty=ICU_CIRCULAR_BUFFER, IcuTimestampNotification=IcuTimestampMeasurement_0_Cbk
    IcuGeneral: IcuDevErrorDetect=0, IcuIndex=0, IcuReportWakeupSource=0
    IcuNonAUTOSAR: IcuEnableDualClockMode=0, IcuOverflowNotificationApi=0, IcuGetInputLevelApi=0, IcuAllowWkpOnAllChls=0, IcuGetCaptureRegisterValueApi=0
    IcuOptionalApis:
      IcuDeInitApi = 0
      IcuDisableWakeupApi = 0
      IcuEdgeCountApi = 1
      IcuEnableWakeupApi = 0
      IcuGetDutyCycleValuesApi = 1
      IcuGetInputStateApi = 1
      IcuGetTimeElapsedApi = 1
      IcuGetVersionInfoApi = 0
      IcuSetModeApi = 1
      IcuSignalMeasurementApi = 1
      IcuTimestampApi = 1
      IcuWakeupFunctionalityApi = 0
      IcuEdgeDetectApi = 1
    CommonPublishedInformation:
      ArReleaseMajorVersion = 4
      ArReleaseMinorVersion = 0
      ArReleaseRevisionVersion = 3
      ModuleId = 122
      SwMajorVersion = 1
      SwMinorVersion = 0
      SwPatchVersion = 1
      VendorId = 43
