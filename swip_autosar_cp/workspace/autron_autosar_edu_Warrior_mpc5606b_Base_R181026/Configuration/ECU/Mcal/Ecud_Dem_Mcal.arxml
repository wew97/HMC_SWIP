AUTOSAR XML (schema 4-0-3)
package /Dem
  module config Dem: implementation-config-variant=VARIANT-POST-BUILD, module-description=BswImplementation_Dem
    DemConfigSet_0 (DemConfigSet)
      15 x DemEventParameter, all with DemEventKind=DEM_EVENT_KIND_BSW, DemMaxNumberFreezeFrameRecords=0:
        ADC_E_TIMEOUT: DemEventId=1
          DemEventClass: DemAgingAllowed=0, DemConsiderPtoStatus=0, DemEventOBDReadinessGroup=DEM_OBD_RDY_AC, DemEventPriority=1, DemFFPrestorageSupported=0
            DemDebounceAlgorithmClass
              DemDebounceAlgorithmClass (DemDebounceCounterBased):
                DemDebounceCounterDecrementStepSize = 0
                DemDebounceCounterFailedThreshold = 0
                DemDebounceCounterIncrementStepSize = 0
                DemDebounceCounterJumpDown = 0
                DemDebounceCounterJumpDownValue = 0
                DemDebounceCounterJumpUp = 0
                DemDebounceCounterJumpUpValue = 0
                DemDebounceCounterPassedThreshold = 0
        FLS_E_COMPARE_FAILED: DemEventId=2
          DemEventClass: DemAgingAllowed=0, DemConsiderPtoStatus=0, DemEventOBDReadinessGroup=DEM_OBD_RDY_AC, DemEventPriority=1, DemFFPrestorageSupported=0
            DemDebounceAlgorithmClass
              DemDebounceAlgorithmClass (DemDebounceCounterBased):
                DemDebounceCounterDecrementStepSize = 0
                DemDebounceCounterFailedThreshold = 0
                DemDebounceCounterIncrementStepSize = 0
                DemDebounceCounterJumpDown = 0
                DemDebounceCounterJumpDownValue = 0
                DemDebounceCounterJumpUp = 0
                DemDebounceCounterJumpUpValue = 0
                DemDebounceCounterPassedThreshold = 0
        FLS_E_ERASE_FAILED: DemEventId=3
          DemEventClass: DemAgingAllowed=0, DemConsiderPtoStatus=0, DemEventOBDReadinessGroup=DEM_OBD_RDY_AC, DemEventPriority=1, DemFFPrestorageSupported=0
            DemDebounceAlgorithmClass
              DemDebounceAlgorithmClass (DemDebounceCounterBased):
                DemDebounceCounterDecrementStepSize = 0
                DemDebounceCounterFailedThreshold = 0
                DemDebounceCounterIncrementStepSize = 0
                DemDebounceCounterJumpDown = 0
                DemDebounceCounterJumpDownValue = 0
                DemDebounceCounterJumpUp = 0
                DemDebounceCounterJumpUpValue = 0
                DemDebounceCounterPassedThreshold = 0
        FLS_E_READ_FAILED: DemEventId=4
          DemEventClass: DemAgingAllowed=0, DemConsiderPtoStatus=0, DemEventOBDReadinessGroup=DEM_OBD_RDY_AC, DemEventPriority=1, DemFFPrestorageSupported=0
            DemDebounceAlgorithmClass
              DemDebounceAlgorithmClass (DemDebounceCounterBased):
                DemDebounceCounterDecrementStepSize = 0
                DemDebounceCounterFailedThreshold = 0
                DemDebounceCounterIncrementStepSize = 0
                DemDebounceCounterJumpDown = 0
                DemDebounceCounterJumpDownValue = 0
                DemDebounceCounterJumpUp = 0
                DemDebounceCounterJumpUpValue = 0
                DemDebounceCounterPassedThreshold = 0
        FLS_E_UNEXPECTED_FLASH_ID: DemEventId=5
          DemEventClass: DemAgingAllowed=0, DemConsiderPtoStatus=0, DemEventOBDReadinessGroup=DEM_OBD_RDY_AC, DemEventPriority=1, DemFFPrestorageSupported=0
            DemDebounceAlgorithmClass
              DemDebounceAlgorithmClass (DemDebounceCounterBased):
                DemDebounceCounterDecrementStepSize = 0
                DemDebounceCounterFailedThreshold = 0
                DemDebounceCounterIncrementStepSize = 0
                DemDebounceCounterJumpDown = 0
                DemDebounceCounterJumpDownValue = 0
                DemDebounceCounterJumpUp = 0
                DemDebounceCounterJumpUpValue = 0
                DemDebounceCounterPassedThreshold = 0
        FLS_E_WRITE_FAILED: DemEventId=6
          DemEventClass: DemAgingAllowed=0, DemConsiderPtoStatus=0, DemEventOBDReadinessGroup=DEM_OBD_RDY_AC, DemEventPriority=1, DemFFPrestorageSupported=0
            DemDebounceAlgorithmClass
              DemDebounceAlgorithmClass (DemDebounceCounterBased):
                DemDebounceCounterDecrementStepSize = 0
                DemDebounceCounterFailedThreshold = 0
                DemDebounceCounterIncrementStepSize = 0
                DemDebounceCounterJumpDown = 0
                DemDebounceCounterJumpDownValue = 0
                DemDebounceCounterJumpUp = 0
                DemDebounceCounterJumpUpValue = 0
                DemDebounceCounterPassedThreshold = 0
        MCU_E_CLOCK_FAILURE: DemEventId=7
          DemEventClass: DemAgingAllowed=0, DemConsiderPtoStatus=0, DemEventOBDReadinessGroup=DEM_OBD_RDY_AC, DemEventPriority=1, DemFFPrestorageSupported=0
            DemDebounceAlgorithmClass
              DemDebounceAlgorithmClass (DemDebounceCounterBased):
                DemDebounceCounterDecrementStepSize = 0
                DemDebounceCounterFailedThreshold = 0
                DemDebounceCounterIncrementStepSize = 0
                DemDebounceCounterJumpDown = 0
                DemDebounceCounterJumpDownValue = 0
                DemDebounceCounterJumpUp = 0
                DemDebounceCounterJumpUpValue = 0
                DemDebounceCounterPassedThreshold = 0
        MCU_E_LOCK_FAILURE: DemEventId=8
          DemEventClass: DemAgingAllowed=0, DemConsiderPtoStatus=0, DemEventOBDReadinessGroup=DEM_OBD_RDY_AC, DemEventPriority=1, DemFFPrestorageSupported=0
            DemDebounceAlgorithmClass
              DemDebounceAlgorithmClass (DemDebounceCounterBased):
                DemDebounceCounterDecrementStepSize = 0
                DemDebounceCounterFailedThreshold = 0
                DemDebounceCounterIncrementStepSize = 0
                DemDebounceCounterJumpDown = 0
                DemDebounceCounterJumpDownValue = 0
                DemDebounceCounterJumpUp = 0
                DemDebounceCounterJumpUpValue = 0
                DemDebounceCounterPassedThreshold = 0
        MCU_E_QUARTZ_FAILURE: DemEventId=9
          DemEventClass: DemAgingAllowed=0, DemConsiderPtoStatus=0, DemEventOBDReadinessGroup=DEM_OBD_RDY_AC, DemEventPriority=1, DemFFPrestorageSupported=0
            DemDebounceAlgorithmClass
              DemDebounceAlgorithmClass (DemDebounceCounterBased):
                DemDebounceCounterDecrementStepSize = 0
                DemDebounceCounterFailedThreshold = 0
                DemDebounceCounterIncrementStepSize = 0
                DemDebounceCounterJumpDown = 0
                DemDebounceCounterJumpDownValue = 0
                DemDebounceCounterJumpUp = 0
                DemDebounceCounterJumpUpValue = 0
                DemDebounceCounterPassedThreshold = 0
        MCU_E_TIMEOUT_TRANSITION: DemEventId=10
          DemEventClass: DemAgingAllowed=0, DemConsiderPtoStatus=0, DemEventOBDReadinessGroup=DEM_OBD_RDY_AC, DemEventPriority=1, DemFFPrestorageSupported=0
            DemDebounceAlgorithmClass
              DemDebounceAlgorithmClass (DemDebounceCounterBased):
                DemDebounceCounterDecrementStepSize = 0
                DemDebounceCounterFailedThreshold = 0
                DemDebounceCounterIncrementStepSize = 0
                DemDebounceCounterJumpDown = 0
                DemDebounceCounterJumpDownValue = 0
                DemDebounceCounterJumpUp = 0
                DemDebounceCounterJumpUpValue = 0
                DemDebounceCounterPassedThreshold = 0
        PWM_E_UNEXPECTED_IRQ: DemEventId=11
          DemEventClass: DemAgingAllowed=0, DemConsiderPtoStatus=0, DemEventOBDReadinessGroup=DEM_OBD_RDY_AC, DemEventPriority=1, DemFFPrestorageSupported=0
            DemDebounceAlgorithmClass
              DemDebounceAlgorithmClass (DemDebounceCounterBased):
                DemDebounceCounterDecrementStepSize = 0
                DemDebounceCounterFailedThreshold = 0
                DemDebounceCounterIncrementStepSize = 0
                DemDebounceCounterJumpDown = 0
                DemDebounceCounterJumpDownValue = 0
                DemDebounceCounterJumpUp = 0
                DemDebounceCounterJumpUpValue = 0
                DemDebounceCounterPassedThreshold = 0
        SPI_E_TIMEOUT: DemEventId=12
          DemEventClass: DemAgingAllowed=0, DemConsiderPtoStatus=0, DemEventOBDReadinessGroup=DEM_OBD_RDY_AC, DemEventPriority=1, DemFFPrestorageSupported=0
            DemDebounceAlgorithmClass
              DemDebounceAlgorithmClass (DemDebounceCounterBased):
                DemDebounceCounterDecrementStepSize = 0
                DemDebounceCounterFailedThreshold = 0
                DemDebounceCounterIncrementStepSize = 0
                DemDebounceCounterJumpDown = 0
                DemDebounceCounterJumpDownValue = 0
                DemDebounceCounterJumpUp = 0
                DemDebounceCounterJumpUpValue = 0
                DemDebounceCounterPassedThreshold = 0
        WDG_E_DISABLE_REJECTED: DemEventId=13
          DemEventClass: DemAgingAllowed=0, DemConsiderPtoStatus=0, DemEventOBDReadinessGroup=DEM_OBD_RDY_AC, DemEventPriority=1, DemFFPrestorageSupported=0
            DemDebounceAlgorithmClass
              DemDebounceAlgorithmClass (DemDebounceCounterBased):
                DemDebounceCounterDecrementStepSize = 0
                DemDebounceCounterFailedThreshold = 0
                DemDebounceCounterIncrementStepSize = 0
                DemDebounceCounterJumpDown = 0
                DemDebounceCounterJumpDownValue = 0
                DemDebounceCounterJumpUp = 0
                DemDebounceCounterJumpUpValue = 0
                DemDebounceCounterPassedThreshold = 0
        WDG_E_MISS_TRIGGER: DemEventId=14
          DemEventClass: DemAgingAllowed=0, DemConsiderPtoStatus=0, DemEventOBDReadinessGroup=DEM_OBD_RDY_AC, DemEventPriority=1, DemFFPrestorageSupported=0
            DemDebounceAlgorithmClass
              DemDebounceAlgorithmClass (DemDebounceCounterBased):
                DemDebounceCounterDecrementStepSize = 0
                DemDebounceCounterFailedThreshold = 0
                DemDebounceCounterIncrementStepSize = 0
                DemDebounceCounterJumpDown = 0
                DemDebounceCounterJumpDownValue = 0
                DemDebounceCounterJumpUp = 0
                DemDebounceCounterJumpUpValue = 0
                DemDebounceCounterPassedThreshold = 0
        WDG_E_MODE_FAILED: DemEventId=15
          DemEventClass: DemAgingAllowed=0, DemConsiderPtoStatus=0, DemEventOBDReadinessGroup=DEM_OBD_RDY_AC, DemEventPriority=1, DemFFPrestorageSupported=0
            DemDebounceAlgorithmClass
              DemDebounceAlgorithmClass (DemDebounceCounterBased):
                DemDebounceCounterDecrementStepSize = 0
                DemDebounceCounterFailedThreshold = 0
                DemDebounceCounterIncrementStepSize = 0
                DemDebounceCounterJumpDown = 0
                DemDebounceCounterJumpDownValue = 0
                DemDebounceCounterJumpUp = 0
                DemDebounceCounterJumpUpValue = 0
                DemDebounceCounterPassedThreshold = 0
    CommonPublishedInformation: ArReleaseMajorVersion=4, ArReleaseMinorVersion=0, ArReleaseRevisionVersion=3, ModuleId=54, SwMajorVersion=1, SwMinorVersion=0, VendorId=43
    DemGeneral: DemMaxNumberEventEntryPrimary=1, DemMaxNumberEventEntrySecondary=1
