AUTOSAR XML (schema 4-0-3)
package /AUTOSAR
  module config Dem: implementation-config-variant=VARIANT-PRE-COMPILE, module-description=BswImplementation_Dem
    DemConfigSet0 (DemConfigSet)
      8 x DemDTCClass, all with DemImmediateNvStorage=1:
        UDS_DTC_0xDD04: DemDTCFunctionalUnit=0x10, DemDTCSeverity=DEM_DTC_SEV_MAINTENANCE_ONLY, DemUdsDTC=0xdd04
        UDS_DTC_0xDD03: DemDTCSeverity=DEM_DTC_SEV_IMMEDIATELY, DemUdsDTC=0xdd03
        UDS_DTC_0xDD02: DemDTCSeverity=DEM_DTC_SEV_IMMEDIATELY, DemUdsDTC=0xdd02
        UDS_DTC_0xDD01: DemDTCSeverity=DEM_DTC_SEV_IMMEDIATELY, DemUdsDTC=0xdd01
        UDS_DTC_0xDD05: DemDTCSeverity=DEM_DTC_SEV_NO_SEVERITY, DemUdsDTC=0xdd05
        UDS_DTC_0xDD06: DemDTCSeverity=DEM_DTC_SEV_NO_SEVERITY, DemUdsDTC=0xDD06
        UDS_DTC_0x400F01: DemDTCSeverity=DEM_DTC_SEV_IMMEDIATELY, DemUdsDTC=0x400F01
        UDS_DTC_0x800F01: DemDTCSeverity=DEM_DTC_SEV_IMMEDIATELY, DemUdsDTC=0x800F01
      69 x DemEventParameter:
        ECUM_E_CONFIGURATION_DATA_INCONSISTENT: DemEventId=19, DemEventKind=DEM_EVENT_KIND_BSW, DemMaxNumberFreezeFrameRecords=0
          DemEventClass0 (DemEventClass):
            DemAgingAllowed = 0
            DemConsiderPtoStatus = 0
            DemEventOBDReadinessGroup = DEM_OBD_RDY_NONE
            DemEventPriority = 1
            DemFFPrestorageSupported = 0
            DemOperationCycleRef = DemOperationCycle0
            DemDebounceAlgorithmClass0 (DemDebounceAlgorithmClass)
        ECUM_E_RAM_CHECK_FAILED: DemEventId=20, DemEventKind=DEM_EVENT_KIND_BSW, DemMaxNumberFreezeFrameRecords=0
          DemEventClass0 (DemEventClass):
            DemAgingAllowed = 0
            DemConsiderPtoStatus = 0
            DemEventOBDReadinessGroup = DEM_OBD_RDY_NONE
            DemEventPriority = 1
            DemFFPrestorageSupported = 0
            DemOperationCycleRef = DemOperationCycle0
            DemDebounceAlgorithmClass0 (DemDebounceAlgorithmClass)
        Dem_FLS_COMPARE_ERROR: DemEventId=22, DemEventKind=DEM_EVENT_KIND_BSW, DemMaxNumberFreezeFrameRecords=0
          DemEventClass0 (DemEventClass):
            DemAgingAllowed = 0
            DemConsiderPtoStatus = 0
            DemEventOBDReadinessGroup = DEM_OBD_RDY_NONE
            DemEventPriority = 1
            DemFFPrestorageSupported = 0
            DemOperationCycleRef = DemOperationCycle0
            DemDebounceAlgorithmClass0 (DemDebounceAlgorithmClass)
        Dem_FLS_ERASE_ERROR: DemEventId=23, DemEventKind=DEM_EVENT_KIND_BSW, DemMaxNumberFreezeFrameRecords=0
          DemEventClass0 (DemEventClass):
            DemAgingAllowed = 0
            DemConsiderPtoStatus = 0
            DemEventOBDReadinessGroup = DEM_OBD_RDY_NONE
            DemEventPriority = 1
            DemFFPrestorageSupported = 0
            DemOperationCycleRef = DemOperationCycle0
            DemDebounceAlgorithmClass0 (DemDebounceAlgorithmClass)
        Dem_FLS_READ_ERROR: DemEventId=24, DemEventKind=DEM_EVENT_KIND_BSW, DemMaxNumberFreezeFrameRecords=0
          DemEventClass0 (DemEventClass):
            DemAgingAllowed = 0
            DemConsiderPtoStatus = 0
            DemEventOBDReadinessGroup = DEM_OBD_RDY_NONE
            DemEventPriority = 1
            DemFFPrestorageSupported = 0
            DemOperationCycleRef = DemOperationCycle0
            DemDebounceAlgorithmClass0 (DemDebounceAlgorithmClass)
        Dem_FLS_WRITE_ERROR: DemEventId=25, DemEventKind=DEM_EVENT_KIND_BSW, DemMaxNumberFreezeFrameRecords=0
          DemEventClass0 (DemEventClass):
            DemAgingAllowed = 0
            DemConsiderPtoStatus = 0
            DemEventOBDReadinessGroup = DEM_OBD_RDY_NONE
            DemEventPriority = 1
            DemFFPrestorageSupported = 0
            DemOperationCycleRef = DemOperationCycle0
            DemDebounceAlgorithmClass0 (DemDebounceAlgorithmClass)
        WDGM_E_IMPROPER_CALLER: DemEventId=26, DemEventKind=DEM_EVENT_KIND_BSW, DemMaxNumberFreezeFrameRecords=0
          DemEventClass0 (DemEventClass):
            DemAgingAllowed = 0
            DemConsiderPtoStatus = 0
            DemEventOBDReadinessGroup = DEM_OBD_RDY_NONE
            DemEventPriority = 1
            DemFFPrestorageSupported = 0
            DemOperationCycleRef = DemOperationCycle0
            DemDebounceAlgorithmClass0 (DemDebounceAlgorithmClass)
        WDGM_E_MONITORING: DemEventId=27, DemEventKind=DEM_EVENT_KIND_BSW, DemMaxNumberFreezeFrameRecords=0
          DemEventClass0 (DemEventClass):
            DemAgingAllowed = 0
            DemConsiderPtoStatus = 0
            DemEventOBDReadinessGroup = DEM_OBD_RDY_NONE
            DemEventPriority = 1
            DemFFPrestorageSupported = 0
            DemOperationCycleRef = DemOperationCycle0
            DemDebounceAlgorithmClass0 (DemDebounceAlgorithmClass)
        WDGM_E_SET_MODE: DemEventId=28, DemEventKind=DEM_EVENT_KIND_BSW, DemMaxNumberFreezeFrameRecords=0
          DemEventClass0 (DemEventClass):
            DemAgingAllowed = 0
            DemConsiderPtoStatus = 0
            DemEventOBDReadinessGroup = DEM_OBD_RDY_NONE
            DemEventPriority = 1
            DemFFPrestorageSupported = 0
            DemOperationCycleRef = DemOperationCycle0
            DemDebounceAlgorithmClass0 (DemDebounceAlgorithmClass)
        Dem_FEE_UNCONFIG_BLK_EXCEEDED_ERROR: DemEventId=29, DemEventKind=DEM_EVENT_KIND_BSW, DemMaxNumberFreezeFrameRecords=0
          DemEventClass0 (DemEventClass):
            DemAgingAllowed = 0
            DemConsiderPtoStatus = 0
            DemEventOBDReadinessGroup = DEM_OBD_RDY_NONE
            DemEventPriority = 1
            DemFFPrestorageSupported = 0
            DemOperationCycleRef = DemOperationCycle0
            DemDebounceAlgorithmClass0 (DemDebounceAlgorithmClass)
        Dem_FEE_GC_INIT_ERROR: DemEventId=30, DemEventKind=DEM_EVENT_KIND_BSW, DemMaxNumberFreezeFrameRecords=0
          DemEventClass0 (DemEventClass):
            DemAgingAllowed = 0
            DemConsiderPtoStatus = 0
            DemEventOBDReadinessGroup = DEM_OBD_RDY_NONE
            DemEventPriority = 1
            DemFFPrestorageSupported = 0
            DemOperationCycleRef = DemOperationCycle0
            DemDebounceAlgorithmClass0 (DemDebounceAlgorithmClass)
        Dem_FEE_GC_TRIG_ERROR: DemEventId=31, DemEventKind=DEM_EVENT_KIND_BSW, DemMaxNumberFreezeFrameRecords=0
          DemEventClass0 (DemEventClass):
            DemAgingAllowed = 0
            DemConsiderPtoStatus = 0
            DemEventOBDReadinessGroup = DEM_OBD_RDY_NONE
            DemEventPriority = 1
            DemFFPrestorageSupported = 0
            DemOperationCycleRef = DemOperationCycle0
            DemDebounceAlgorithmClass0 (DemDebounceAlgorithmClass)
        Dem_FEE_WRITE_ERROR: DemEventId=32, DemEventKind=DEM_EVENT_KIND_BSW, DemMaxNumberFreezeFrameRecords=0
          DemEventClass0 (DemEventClass):
            DemAgingAllowed = 0
            DemConsiderPtoStatus = 0
            DemEventOBDReadinessGroup = DEM_OBD_RDY_NONE
            DemEventPriority = 1
            DemFFPrestorageSupported = 0
            DemOperationCycleRef = DemOperationCycle0
            DemDebounceAlgorithmClass0 (DemDebounceAlgorithmClass)
        Dem_FEE_READ_ERROR: DemEventId=33, DemEventKind=DEM_EVENT_KIND_BSW, DemMaxNumberFreezeFrameRecords=0
          DemEventClass0 (DemEventClass):
            DemAgingAllowed = 0
            DemConsiderPtoStatus = 0
            DemEventOBDReadinessGroup = DEM_OBD_RDY_NONE
            DemEventPriority = 1
            DemFFPrestorageSupported = 0
            DemOperationCycleRef = DemOperationCycle0
            DemDebounceAlgorithmClass0 (DemDebounceAlgorithmClass)
        Dem_FEE_GC_WRITE_ERROR: DemEventId=34, DemEventKind=DEM_EVENT_KIND_BSW, DemMaxNumberFreezeFrameRecords=0
          DemEventClass0 (DemEventClass):
            DemAgingAllowed = 0
            DemConsiderPtoStatus = 0
            DemEventOBDReadinessGroup = DEM_OBD_RDY_NONE
            DemEventPriority = 1
            DemFFPrestorageSupported = 0
            DemOperationCycleRef = DemOperationCycle0
            DemDebounceAlgorithmClass0 (DemDebounceAlgorithmClass)
        Dem_FEE_GC_READ_ERROR: DemEventId=35, DemEventKind=DEM_EVENT_KIND_BSW, DemMaxNumberFreezeFrameRecords=0
          DemEventClass0 (DemEventClass):
            DemAgingAllowed = 0
            DemConsiderPtoStatus = 0
            DemEventOBDReadinessGroup = DEM_OBD_RDY_NONE
            DemEventPriority = 1
            DemFFPrestorageSupported = 0
            DemOperationCycleRef = DemOperationCycle0
            DemDebounceAlgorithmClass0 (DemDebounceAlgorithmClass)
        Dem_FEE_GC_ERASE_ERROR: DemEventId=36, DemEventKind=DEM_EVENT_KIND_BSW, DemMaxNumberFreezeFrameRecords=0
          DemEventClass0 (DemEventClass):
            DemAgingAllowed = 0
            DemConsiderPtoStatus = 0
            DemEventOBDReadinessGroup = DEM_OBD_RDY_NONE
            DemEventPriority = 1
            DemFFPrestorageSupported = 0
            DemOperationCycleRef = DemOperationCycle0
            DemDebounceAlgorithmClass0 (DemDebounceAlgorithmClass)
        Dem_FEE_INVALIDATE_ERROR: DemEventId=37, DemEventKind=DEM_EVENT_KIND_BSW, DemMaxNumberFreezeFrameRecords=0
          DemEventClass0 (DemEventClass):
            DemAgingAllowed = 0
            DemConsiderPtoStatus = 0
            DemEventOBDReadinessGroup = DEM_OBD_RDY_NONE
            DemEventPriority = 1
            DemFFPrestorageSupported = 0
            DemOperationCycleRef = DemOperationCycle0
            DemDebounceAlgorithmClass0 (DemDebounceAlgorithmClass)
        NVM_E_INTEGRITY_FAILED: DemEventId=38, DemEventKind=DEM_EVENT_KIND_BSW, DemMaxNumberFreezeFrameRecords=0
          DemEventClass0 (DemEventClass):
            DemAgingAllowed = 0
            DemConsiderPtoStatus = 0
            DemEventOBDReadinessGroup = DEM_OBD_RDY_NONE
            DemEventPriority = 1
            DemFFPrestorageSupported = 0
            DemOperationCycleRef = DemOperationCycle0
            DemDebounceAlgorithmClass0 (DemDebounceAlgorithmClass)
        NVM_E_LOSS_OF_REDUNDANCY: DemEventId=39, DemEventKind=DEM_EVENT_KIND_BSW, DemMaxNumberFreezeFrameRecords=0
          DemEventClass0 (DemEventClass):
            DemAgingAllowed = 0
            DemConsiderPtoStatus = 0
            DemEventOBDReadinessGroup = DEM_OBD_RDY_NONE
            DemEventPriority = 1
            DemFFPrestorageSupported = 0
            DemOperationCycleRef = DemOperationCycle0
            DemDebounceAlgorithmClass0 (DemDebounceAlgorithmClass)
        NVM_E_QUEUE_OVERFLOW: DemEventId=40, DemEventKind=DEM_EVENT_KIND_BSW, DemMaxNumberFreezeFrameRecords=0
          DemEventClass0 (DemEventClass):
            DemAgingAllowed = 0
            DemConsiderPtoStatus = 0
            DemEventOBDReadinessGroup = DEM_OBD_RDY_NONE
            DemEventPriority = 1
            DemFFPrestorageSupported = 0
            DemOperationCycleRef = DemOperationCycle0
            DemDebounceAlgorithmClass0 (DemDebounceAlgorithmClass)
        NVM_E_REQ_FAILED: DemEventId=41, DemEventKind=DEM_EVENT_KIND_BSW, DemMaxNumberFreezeFrameRecords=0
          DemEventClass0 (DemEventClass):
            DemAgingAllowed = 0
            DemConsiderPtoStatus = 0
            DemEventOBDReadinessGroup = DEM_OBD_RDY_NONE
            DemEventPriority = 1
            DemFFPrestorageSupported = 0
            DemOperationCycleRef = DemOperationCycle0
            DemDebounceAlgorithmClass0 (DemDebounceAlgorithmClass)
        NVM_E_VERIFY_FAILED: DemEventId=42, DemEventKind=DEM_EVENT_KIND_BSW, DemMaxNumberFreezeFrameRecords=0
          DemEventClass0 (DemEventClass):
            DemAgingAllowed = 0
            DemConsiderPtoStatus = 0
            DemEventOBDReadinessGroup = DEM_OBD_RDY_NONE
            DemEventPriority = 1
            DemFFPrestorageSupported = 0
            DemOperationCycleRef = DemOperationCycle0
            DemDebounceAlgorithmClass0 (DemDebounceAlgorithmClass)
        NVM_E_WRITE_PROTECTED: DemEventId=43, DemEventKind=DEM_EVENT_KIND_BSW, DemMaxNumberFreezeFrameRecords=0
          DemEventClass0 (DemEventClass):
            DemAgingAllowed = 0
            DemConsiderPtoStatus = 0
            DemEventOBDReadinessGroup = DEM_OBD_RDY_NONE
            DemEventPriority = 1
            DemFFPrestorageSupported = 0
            DemOperationCycleRef = DemOperationCycle0
            DemDebounceAlgorithmClass0 (DemDebounceAlgorithmClass)
        NVM_E_WRONG_BLOCK_ID: DemEventId=44, DemEventKind=DEM_EVENT_KIND_BSW, DemMaxNumberFreezeFrameRecords=0
          DemEventClass0 (DemEventClass):
            DemAgingAllowed = 0
            DemConsiderPtoStatus = 0
            DemEventOBDReadinessGroup = DEM_OBD_RDY_NONE
            DemEventPriority = 1
            DemFFPrestorageSupported = 0
            DemOperationCycleRef = DemOperationCycle0
            DemDebounceAlgorithmClass0 (DemDebounceAlgorithmClass)
        ECUM_E_IMPROPER_CALLER: DemEventId=48, DemEventKind=DEM_EVENT_KIND_BSW, DemMaxNumberFreezeFrameRecords=0
          DemEventClass0 (DemEventClass):
            DemAgingAllowed = 0
            DemConsiderPtoStatus = 0
            DemEventOBDReadinessGroup = DEM_OBD_RDY_NONE
            DemEventPriority = 1
            DemFFPrestorageSupported = 0
            DemOperationCycleRef = DemOperationCycle0
            DemDebounceAlgorithmClass0 (DemDebounceAlgorithmClass)
        CANSM_E_BUS_OFF: DemEventId=53, DemEventKind=DEM_EVENT_KIND_BSW, DemMaxNumberFreezeFrameRecords=0, DemDTCClassRef=UDS_DTC_0xDD06
          DemEventClass0 (DemEventClass):
            DemAgingAllowed = 1
            DemAgingCycleCounterThreshold = 0
            DemConsiderPtoStatus = 0
            DemEventDestination = DEM_DTC_ORIGIN_PRIMARY_MEMORY
            DemEventFailureCycleCounterThreshold = 1
            DemEventOBDReadinessGroup = DEM_OBD_RDY_NONE
            DemEventPriority = 8
            DemEventSignificance = DEM_EVENT_SIGNIFICANCE_FAULT
            DemFFPrestorageSupported = 0
            DemAgingCycleRef = DemOperationCycle0
            DemOperationCycleRef = DemOperationCycle0
            DemDebounceAlgorithmClass0 (DemDebounceAlgorithmClass)
              DemDebounceCounterBased_0 (DemDebounceCounterBased):
                DemDebounceCounterDecrementStepSize = 1
                DemDebounceCounterFailedThreshold = 8
                DemDebounceCounterIncrementStepSize = 1
                DemDebounceCounterJumpDown = 1
                DemDebounceCounterJumpDownValue = 0
                DemDebounceCounterJumpUp = 0
                DemDebounceCounterJumpUpValue = 1
                DemDebounceCounterPassedThreshold = -1
            DemIndicatorAttribute0 (DemIndicatorAttribute):
              DemIndicatorBehaviour = DEM_INDICATOR_BLINKING
              DemIndicatorFailureCycleCounterThreshold = 0
              DemIndicatorHealingCycleCounterThreshold = 1
              DemIndicatorRef = DemIndicator_0
        EEP_E_COMPARE_FAILED: DemEventId=49, DemEventKind=DEM_EVENT_KIND_BSW, DemMaxNumberFreezeFrameRecords=0
          DemEventClass0 (DemEventClass):
            DemAgingAllowed = 0
            DemConsiderPtoStatus = 0
            DemEventOBDReadinessGroup = DEM_OBD_RDY_NONE
            DemEventPriority = 1
            DemFFPrestorageSupported = 0
            DemOperationCycleRef = DemOperationCycle0
            DemDebounceAlgorithmClass0 (DemDebounceAlgorithmClass)
        EEP_E_ERASE_FAILED: DemEventId=50, DemEventKind=DEM_EVENT_KIND_BSW, DemMaxNumberFreezeFrameRecords=0
          DemEventClass0 (DemEventClass):
            DemAgingAllowed = 0
            DemConsiderPtoStatus = 0
            DemEventOBDReadinessGroup = DEM_OBD_RDY_NONE
            DemEventPriority = 1
            DemFFPrestorageSupported = 0
            DemOperationCycleRef = DemOperationCycle0
            DemDebounceAlgorithmClass0 (DemDebounceAlgorithmClass)
        EEP_E_READ_FAILED: DemEventId=51, DemEventKind=DEM_EVENT_KIND_BSW, DemMaxNumberFreezeFrameRecords=0
          DemEventClass0 (DemEventClass):
            DemAgingAllowed = 0
            DemConsiderPtoStatus = 0
            DemEventOBDReadinessGroup = DEM_OBD_RDY_NONE
            DemEventPriority = 1
            DemFFPrestorageSupported = 0
            DemOperationCycleRef = DemOperationCycle0
            DemDebounceAlgorithmClass0 (DemDebounceAlgorithmClass)
        EEP_E_WRITE_FAILED: DemEventId=52, DemEventKind=DEM_EVENT_KIND_BSW, DemMaxNumberFreezeFrameRecords=0
          DemEventClass0 (DemEventClass):
            DemAgingAllowed = 0
            DemConsiderPtoStatus = 0
            DemEventOBDReadinessGroup = DEM_OBD_RDY_NONE
            DemEventPriority = 1
            DemFFPrestorageSupported = 0
            DemOperationCycleRef = DemOperationCycle0
            DemDebounceAlgorithmClass0 (DemDebounceAlgorithmClass)
        DEM_E_TEST_EVENT1: DemEventId=21, DemEventKind=DEM_EVENT_KIND_SWC, DemMaxNumberFreezeFrameRecords=1, DemDTCClassRef=UDS_DTC_0xDD01, DemExtendedDataClassRef=ED_TEST_01, DemFreezeFrameClassRef=DemFreezeFrameClass0
          DemCallbackEventStatusChanged0 (DemCallbackEventStatusChanged)
          DemCallbackInitMForE_0 (DemCallbackInitMForE)
          DemEventClass0 (DemEventClass):
            DemAgingAllowed = 1
            DemAgingCycleCounterThreshold = 3
            DemConsiderPtoStatus = 0
            DemEventDestination = DEM_DTC_ORIGIN_PRIMARY_MEMORY
            DemEventFailureCycleCounterThreshold = 1
            DemEventOBDReadinessGroup = DEM_OBD_RDY_NONE
            DemEventPriority = 2
            DemFFPrestorageSupported = 0
            DemAgingCycleRef = DemOperationCycle0
            DemOperationCycleRef = DemOperationCycle0
            DemEnableConditionGroupRef = DemEnableConditionGroup
            DemDebounceAlgorithmClass_0 (DemDebounceAlgorithmClass)
              DemDebounceCounterBased_0 (DemDebounceCounterBased):
                DemDebounceCounterDecrementStepSize = 1
                DemDebounceCounterFailedThreshold = 1
                DemDebounceCounterIncrementStepSize = 1
                DemDebounceCounterJumpDown = 0
                DemDebounceCounterJumpDownValue = 0
                DemDebounceCounterJumpUp = 0
                DemDebounceCounterJumpUpValue = 0
                DemDebounceCounterPassedThreshold = -1
            DemIndicatorAttribute0 (DemIndicatorAttribute):
              DemIndicatorBehaviour = DEM_INDICATOR_BLINKING
              DemIndicatorFailureCycleCounterThreshold = 0
              DemIndicatorHealingCycleCounterThreshold = 0
              DemIndicatorRef = DemIndicator_0
        DEM_E_TEST_EVENT3: DemEventId=46, DemEventKind=DEM_EVENT_KIND_SWC, DemMaxNumberFreezeFrameRecords=0, DemDTCClassRef=UDS_DTC_0xDD03, DemExtendedDataClassRef=ED_TEST_03
          DemEventClass0 (DemEventClass):
            DemAgingAllowed = 1
            DemAgingCycleCounterThreshold = 1
            DemConsiderPtoStatus = 0
            DemEventDestination = DEM_DTC_ORIGIN_PRIMARY_MEMORY
            DemEventFailureCycleCounterThreshold = 1
            DemEventOBDReadinessGroup = DEM_OBD_RDY_NONE
            DemEventPriority = 3
            DemFFPrestorageSupported = 0
            DemAgingCycleRef = DemOperationCycle0
            DemOperationCycleRef = DemOperationCycle0
            DemDebounceAlgorithmClass0 (DemDebounceAlgorithmClass)
              DemDebounceCounterBased_0 (DemDebounceCounterBased):
                DemDebounceCounterDecrementStepSize = 1
                DemDebounceCounterFailedThreshold = 1
                DemDebounceCounterIncrementStepSize = 1
                DemDebounceCounterJumpDown = 0
                DemDebounceCounterJumpDownValue = 0
                DemDebounceCounterJumpUp = 0
                DemDebounceCounterJumpUpValue = 0
                DemDebounceCounterPassedThreshold = -1
            DemIndicatorAttribute:
              DemIndicatorBehaviour = DEM_INDICATOR_CONTINUOUS
              DemIndicatorFailureCycleCounterThreshold = 0
              DemIndicatorHealingCycleCounterThreshold = 1
              DemIndicatorRef = DemIndicator_0
        DEM_E_TEST_EVENT2: DemEventId=45, DemEventKind=DEM_EVENT_KIND_SWC, DemMaxNumberFreezeFrameRecords=2, DemDTCClassRef=UDS_DTC_0xDD02, DemExtendedDataClassRef=ED_TEST_02, DemFreezeFrameClassRef=DemFreezeFrameClass1
          DemEventClass0 (DemEventClass):
            DemAgingAllowed = 1
            DemAgingCycleCounterThreshold = 1
            DemConsiderPtoStatus = 0
            DemEventDestination = DEM_DTC_ORIGIN_PRIMARY_MEMORY
            DemEventOBDReadinessGroup = DEM_OBD_RDY_NONE
            DemEventPriority = 2
            DemFFPrestorageSupported = 0
            DemAgingCycleRef = DemOperationCycle0
            DemOperationCycleRef = DemOperationCycle0
            DemDebounceAlgorithmClass0 (DemDebounceAlgorithmClass)
              DemDebounceTimeBase: DemDebounceTimeFailedThreshold=0.01, DemDebounceTimePassedThreshold=0.01
            DemIndicatorAttribute:
              DemIndicatorBehaviour = DEM_INDICATOR_BLINKING
              DemIndicatorFailureCycleCounterThreshold = 0
              DemIndicatorHealingCycleCounterThreshold = 0
              DemIndicatorRef = DemIndicator_1
        DEM_E_TEST_EVENT4: DemEventId=47, DemEventKind=DEM_EVENT_KIND_SWC, DemMaxNumberFreezeFrameRecords=0, DemDTCClassRef=UDS_DTC_0xDD04, DemExtendedDataClassRef=ED_TEST_04
          DemEventClass0 (DemEventClass):
            DemAgingAllowed = 1
            DemAgingCycleCounterThreshold = 1
            DemConsiderPtoStatus = 0
            DemEventDestination = DEM_DTC_ORIGIN_PRIMARY_MEMORY
            DemEventFailureCycleCounterThreshold = 1
            DemEventOBDReadinessGroup = DEM_OBD_RDY_NONE
            DemEventPriority = 4
            DemFFPrestorageSupported = 0
            DemAgingCycleRef = DemOperationCycle0
            DemOperationCycleRef = DemOperationCycle0
            DemDebounceAlgorithmClass0 (DemDebounceAlgorithmClass)
              DemDebounceCounterBased_0 (DemDebounceCounterBased):
                DemDebounceCounterDecrementStepSize = 1
                DemDebounceCounterFailedThreshold = 1
                DemDebounceCounterIncrementStepSize = 1
                DemDebounceCounterJumpDown = 0
                DemDebounceCounterJumpDownValue = 0
                DemDebounceCounterJumpUp = 0
                DemDebounceCounterJumpUpValue = 0
                DemDebounceCounterPassedThreshold = -1
            DemIndicatorAttribute0 (DemIndicatorAttribute):
              DemIndicatorBehaviour = DEM_INDICATOR_BLINKING
              DemIndicatorFailureCycleCounterThreshold = 2
              DemIndicatorHealingCycleCounterThreshold = 1
              DemIndicatorRef = DemIndicator_0
        DEM_E_TEST_EVENT5: DemEventId=54, DemEventKind=DEM_EVENT_KIND_SWC, DemMaxNumberFreezeFrameRecords=0, DemDTCClassRef=UDS_DTC_0x400F01
          DemEventClass0 (DemEventClass):
            DemAgingAllowed = 1
            DemAgingCycleCounterThreshold = 1
            DemConsiderPtoStatus = 0
            DemEventDestination = DEM_DTC_ORIGIN_PRIMARY_MEMORY
            DemEventFailureCycleCounterThreshold = 1
            DemEventOBDReadinessGroup = DEM_OBD_RDY_NONE
            DemEventPriority = 4
            DemFFPrestorageSupported = 0
            DemAgingCycleRef = DemOperationCycle0
            DemOperationCycleRef = DemOperationCycle0
            DemDebounceAlgorithmClass0 (DemDebounceAlgorithmClass)
              DemDebounceCounterBased_0 (DemDebounceCounterBased):
                DemDebounceCounterDecrementStepSize = 1
                DemDebounceCounterFailedThreshold = 1
                DemDebounceCounterIncrementStepSize = 1
                DemDebounceCounterJumpDown = 0
                DemDebounceCounterJumpDownValue = 0
                DemDebounceCounterJumpUp = 0
                DemDebounceCounterJumpUpValue = 0
                DemDebounceCounterPassedThreshold = -1
            DemIndicatorAttribute0 (DemIndicatorAttribute):
              DemIndicatorBehaviour = DEM_INDICATOR_BLINKING
              DemIndicatorFailureCycleCounterThreshold = 0
              DemIndicatorHealingCycleCounterThreshold = 1
              DemIndicatorRef = DemIndicator_0
        DEM_E_TEST_EVENT6: DemEventId=55, DemEventKind=DEM_EVENT_KIND_SWC, DemMaxNumberFreezeFrameRecords=0, DemDTCClassRef=UDS_DTC_0x800F01
          DemEventClass0 (DemEventClass):
            DemAgingAllowed = 1
            DemAgingCycleCounterThreshold = 1
            DemConsiderPtoStatus = 0
            DemEventDestination = DEM_DTC_ORIGIN_PRIMARY_MEMORY
            DemEventFailureCycleCounterThreshold = 1
            DemEventOBDReadinessGroup = DEM_OBD_RDY_NONE
            DemEventPriority = 4
            DemFFPrestorageSupported = 0
            DemAgingCycleRef = DemOperationCycle0
            DemOperationCycleRef = DemOperationCycle0
            DemDebounceAlgorithmClass0 (DemDebounceAlgorithmClass)
              DemDebounceCounterBased_0 (DemDebounceCounterBased):
                DemDebounceCounterDecrementStepSize = 1
                DemDebounceCounterFailedThreshold = 1
                DemDebounceCounterIncrementStepSize = 1
                DemDebounceCounterJumpDown = 0
                DemDebounceCounterJumpDownValue = 0
                DemDebounceCounterJumpUp = 0
                DemDebounceCounterJumpUpValue = 0
                DemDebounceCounterPassedThreshold = -1
            DemIndicatorAttribute0 (DemIndicatorAttribute):
              DemIndicatorBehaviour = DEM_INDICATOR_BLINKING
              DemIndicatorFailureCycleCounterThreshold = 0
              DemIndicatorHealingCycleCounterThreshold = 1
              DemIndicatorRef = DemIndicator_0
        IOHWAB_E_WRONG_STATE: DemEventId=56, DemEventKind=DEM_EVENT_KIND_BSW, DemMaxNumberFreezeFrameRecords=0
          DemEventClass:
            DemAgingAllowed = 0
            DemConsiderPtoStatus = 0
            DemEventFailureCycleCounterThreshold = 1
            DemEventOBDReadinessGroup = DEM_OBD_RDY_NONE
            DemEventPriority = 1
            DemFFPrestorageSupported = 0
            DemOperationCycleRef = DemOperationCycle0
            DemDebounceAlgorithmClass
        IOHWAB_E_WRONG_SETTING: DemEventId=57, DemEventKind=DEM_EVENT_KIND_BSW, DemMaxNumberFreezeFrameRecords=0
          DemEventClass:
            DemAgingAllowed = 0
            DemConsiderPtoStatus = 0
            DemEventFailureCycleCounterThreshold = 1
            DemEventOBDReadinessGroup = DEM_OBD_RDY_NONE
            DemEventPriority = 1
            DemFFPrestorageSupported = 0
            DemOperationCycleRef = DemOperationCycle0
            DemDebounceAlgorithmClass
        IOHWAB_E_WRONG_PARAM: DemEventId=58, DemEventKind=DEM_EVENT_KIND_BSW, DemMaxNumberFreezeFrameRecords=0
          DemEventClass:
            DemAgingAllowed = 0
            DemConsiderPtoStatus = 0
            DemEventFailureCycleCounterThreshold = 1
            DemEventOBDReadinessGroup = DEM_OBD_RDY_NONE
            DemEventPriority = 1
            DemFFPrestorageSupported = 0
            DemOperationCycleRef = DemOperationCycle0
            DemDebounceAlgorithmClass
        IOHWAB_E_SETUP_FAIL: DemEventId=59, DemEventKind=DEM_EVENT_KIND_BSW, DemMaxNumberFreezeFrameRecords=0
          DemEventClass:
            DemAgingAllowed = 0
            DemConsiderPtoStatus = 0
            DemEventFailureCycleCounterThreshold = 1
            DemEventOBDReadinessGroup = DEM_OBD_RDY_NONE
            DemEventPriority = 1
            DemFFPrestorageSupported = 0
            DemOperationCycleRef = DemOperationCycle0
            DemDebounceAlgorithmClass
        IOHWAB_E_PROC_FAIL: DemEventId=61, DemEventKind=DEM_EVENT_KIND_BSW, DemMaxNumberFreezeFrameRecords=0
          DemEventClass:
            DemAgingAllowed = 0
            DemConsiderPtoStatus = 0
            DemEventFailureCycleCounterThreshold = 1
            DemEventOBDReadinessGroup = DEM_OBD_RDY_NONE
            DemEventPriority = 1
            DemFFPrestorageSupported = 0
            DemOperationCycleRef = DemOperationCycle0
            DemDebounceAlgorithmClass
        IOHWAB_E_BUSY: DemEventId=60, DemEventKind=DEM_EVENT_KIND_BSW, DemMaxNumberFreezeFrameRecords=0
          DemEventClass:
            DemAgingAllowed = 0
            DemConsiderPtoStatus = 0
            DemEventFailureCycleCounterThreshold = 1
            DemEventOBDReadinessGroup = DEM_OBD_RDY_NONE
            DemEventPriority = 1
            DemFFPrestorageSupported = 0
            DemOperationCycleRef = DemOperationCycle0
            DemDebounceAlgorithmClass
        CANCM_E_BAT_FAIL: DemEventId=62, DemEventKind=DEM_EVENT_KIND_BSW, DemMaxNumberFreezeFrameRecords=0
          DemEventClass0 (DemEventClass):
            DemAgingAllowed = 1
            DemAgingCycleCounterThreshold = 0
            DemConsiderPtoStatus = 0
            DemEventDestination = DEM_DTC_ORIGIN_PRIMARY_MEMORY
            DemEventFailureCycleCounterThreshold = 1
            DemEventOBDReadinessGroup = DEM_OBD_RDY_NONE
            DemEventPriority = 8
            DemEventSignificance = DEM_EVENT_SIGNIFICANCE_FAULT
            DemFFPrestorageSupported = 0
            DemAgingCycleRef = DemOperationCycle0
            DemOperationCycleRef = DemOperationCycle0
            DemDebounceAlgorithmClass0 (DemDebounceAlgorithmClass)
        RAMTST_E_RAM_FAILURE: DemEventId=63, DemEventKind=DEM_EVENT_KIND_BSW, DemMaxNumberFreezeFrameRecords=0
          DemEventClass:
            DemAgingAllowed = 0
            DemConsiderPtoStatus = 0
            DemEventOBDReadinessGroup = DEM_OBD_RDY_NONE
            DemEventPriority = 1
            DemFFPrestorageSupported = 0
            DemOperationCycleRef = DemOperationCycle0
        ETHTRCV_E_ACCESS: DemEventId=64, DemEventKind=DEM_EVENT_KIND_BSW, DemMaxNumberFreezeFrameRecords=0
          DemEventClass:
            DemAgingAllowed = 0
            DemConsiderPtoStatus = 0
            DemEventOBDReadinessGroup = DEM_OBD_RDY_NONE
            DemEventPriority = 1
            DemFFPrestorageSupported = 0
            DemOperationCycleRef = DemOperationCycle0
        ETHSM_E_LINK_DOWN: DemEventId=65, DemEventKind=DEM_EVENT_KIND_BSW, DemMaxNumberFreezeFrameRecords=0
          DemEventClass:
            DemAgingAllowed = 0
            DemConsiderPtoStatus = 0
            DemEventOBDReadinessGroup = DEM_OBD_RDY_NONE
            DemEventPriority = 1
            DemFFPrestorageSupported = 0
            DemOperationCycleRef = DemOperationCycle0
        WDG_76_ACW_E_DISABLE_REJECTED: DemEventId=66, DemEventKind=DEM_EVENT_KIND_BSW, DemMaxNumberFreezeFrameRecords=0
          DemEventClass:
            DemAgingAllowed = 0
            DemConsiderPtoStatus = 0
            DemEventOBDReadinessGroup = DEM_OBD_RDY_NONE
            DemEventPriority = 1
            DemFFPrestorageSupported = 0
            DemOperationCycleRef = DemOperationCycle0
        WDG_76_ACW_E_MODE_FAILED: DemEventId=67, DemEventKind=DEM_EVENT_KIND_BSW, DemMaxNumberFreezeFrameRecords=0
          DemEventClass:
            DemAgingAllowed = 0
            DemConsiderPtoStatus = 0
            DemEventOBDReadinessGroup = DEM_OBD_RDY_NONE
            DemEventPriority = 1
            DemFFPrestorageSupported = 0
            DemOperationCycleRef = DemOperationCycle0
        ADC_E_TIMEOUT: DemEventId=1, DemEventKind=DEM_EVENT_KIND_BSW, DemMaxNumberFreezeFrameRecords=0
          DemEventClass0 (DemEventClass):
            DemAgingAllowed = 0
            DemConsiderPtoStatus = 0
            DemEventOBDReadinessGroup = DEM_OBD_RDY_NONE
            DemEventPriority = 1
            DemFFPrestorageSupported = 0
            DemOperationCycleRef = DemOperationCycle0
            DemDebounceAlgorithmClass0 (DemDebounceAlgorithmClass)
        ETH_E_ACCESS: DemEventId=2, DemEventKind=DEM_EVENT_KIND_BSW, DemMaxNumberFreezeFrameRecords=0
          DemEventClass0 (DemEventClass):
            DemAgingAllowed = 0
            DemConsiderPtoStatus = 0
            DemEventOBDReadinessGroup = DEM_OBD_RDY_NONE
            DemEventPriority = 1
            DemFFPrestorageSupported = 0
            DemOperationCycleRef = DemOperationCycle0
            DemDebounceAlgorithmClass0 (DemDebounceAlgorithmClass)
        FLS_E_WRITE_FAILED: DemEventId=3, DemEventKind=DEM_EVENT_KIND_BSW, DemMaxNumberFreezeFrameRecords=0
          DemEventClass0 (DemEventClass):
            DemAgingAllowed = 0
            DemConsiderPtoStatus = 0
            DemEventOBDReadinessGroup = DEM_OBD_RDY_NONE
            DemEventPriority = 1
            DemFFPrestorageSupported = 0
            DemOperationCycleRef = DemOperationCycle0
            DemDebounceAlgorithmClass0 (DemDebounceAlgorithmClass)
        FLS_E_ERASE_FAILED: DemEventId=4, DemEventKind=DEM_EVENT_KIND_BSW, DemMaxNumberFreezeFrameRecords=0
          DemEventClass0 (DemEventClass):
            DemAgingAllowed = 0
            DemConsiderPtoStatus = 0
            DemEventOBDReadinessGroup = DEM_OBD_RDY_NONE
            DemEventPriority = 1
            DemFFPrestorageSupported = 0
            DemOperationCycleRef = DemOperationCycle0
            DemDebounceAlgorithmClass0 (DemDebounceAlgorithmClass)
        FLS_E_READ_FAILED: DemEventId=5, DemEventKind=DEM_EVENT_KIND_BSW, DemMaxNumberFreezeFrameRecords=0
          DemEventClass0 (DemEventClass):
            DemAgingAllowed = 0
            DemConsiderPtoStatus = 0
            DemEventOBDReadinessGroup = DEM_OBD_RDY_NONE
            DemEventPriority = 1
            DemFFPrestorageSupported = 0
            DemOperationCycleRef = DemOperationCycle0
            DemDebounceAlgorithmClass0 (DemDebounceAlgorithmClass)
        FLS_E_COMPARE_FAILED: DemEventId=6, DemEventKind=DEM_EVENT_KIND_BSW, DemMaxNumberFreezeFrameRecords=0
          DemEventClass0 (DemEventClass):
            DemAgingAllowed = 0
            DemConsiderPtoStatus = 0
            DemEventOBDReadinessGroup = DEM_OBD_RDY_NONE
            DemEventPriority = 1
            DemFFPrestorageSupported = 0
            DemOperationCycleRef = DemOperationCycle0
            DemDebounceAlgorithmClass0 (DemDebounceAlgorithmClass)
        FLS_E_UNEXPECTED_FLASH_ID: DemEventId=7, DemEventKind=DEM_EVENT_KIND_BSW, DemMaxNumberFreezeFrameRecords=0
          DemEventClass0 (DemEventClass):
            DemAgingAllowed = 0
            DemConsiderPtoStatus = 0
            DemEventOBDReadinessGroup = DEM_OBD_RDY_NONE
            DemEventPriority = 1
            DemFFPrestorageSupported = 0
            DemOperationCycleRef = DemOperationCycle0
            DemDebounceAlgorithmClass0 (DemDebounceAlgorithmClass)
        FR_E_ACCESS: DemEventId=8, DemEventKind=DEM_EVENT_KIND_BSW, DemMaxNumberFreezeFrameRecords=0
          DemEventClass0 (DemEventClass):
            DemAgingAllowed = 0
            DemConsiderPtoStatus = 0
            DemEventOBDReadinessGroup = DEM_OBD_RDY_NONE
            DemEventPriority = 1
            DemFFPrestorageSupported = 0
            DemOperationCycleRef = DemOperationCycle0
            DemDebounceAlgorithmClass0 (DemDebounceAlgorithmClass)
        LIN_E_TIMEOUT: DemEventId=9, DemEventKind=DEM_EVENT_KIND_BSW, DemMaxNumberFreezeFrameRecords=0
          DemEventClass0 (DemEventClass):
            DemAgingAllowed = 0
            DemConsiderPtoStatus = 0
            DemEventOBDReadinessGroup = DEM_OBD_RDY_NONE
            DemEventPriority = 1
            DemFFPrestorageSupported = 0
            DemOperationCycleRef = DemOperationCycle0
            DemDebounceAlgorithmClass0 (DemDebounceAlgorithmClass)
        MCU_E_CLOCK_FAILURE: DemEventId=10, DemEventKind=DEM_EVENT_KIND_BSW, DemMaxNumberFreezeFrameRecords=0
          DemEventClass0 (DemEventClass):
            DemAgingAllowed = 0
            DemConsiderPtoStatus = 0
            DemEventOBDReadinessGroup = DEM_OBD_RDY_NONE
            DemEventPriority = 1
            DemFFPrestorageSupported = 0
            DemOperationCycleRef = DemOperationCycle0
            DemDebounceAlgorithmClass0 (DemDebounceAlgorithmClass)
        MCU_E_LOCK_FAILURE: DemEventId=11, DemEventKind=DEM_EVENT_KIND_BSW, DemMaxNumberFreezeFrameRecords=0
          DemEventClass0 (DemEventClass):
            DemAgingAllowed = 0
            DemConsiderPtoStatus = 0
            DemEventOBDReadinessGroup = DEM_OBD_RDY_NONE
            DemEventPriority = 1
            DemFFPrestorageSupported = 0
            DemOperationCycleRef = DemOperationCycle0
            DemDebounceAlgorithmClass0 (DemDebounceAlgorithmClass)
        MCU_E_QUARTZ_FAILURE: DemEventId=12, DemEventKind=DEM_EVENT_KIND_BSW, DemMaxNumberFreezeFrameRecords=0
          DemEventClass0 (DemEventClass):
            DemAgingAllowed = 0
            DemConsiderPtoStatus = 0
            DemEventOBDReadinessGroup = DEM_OBD_RDY_NONE
            DemEventPriority = 1
            DemFFPrestorageSupported = 0
            DemOperationCycleRef = DemOperationCycle0
            DemDebounceAlgorithmClass0 (DemDebounceAlgorithmClass)
        MCU_E_TIMEOUT_TRANSITION: DemEventId=13, DemEventKind=DEM_EVENT_KIND_BSW, DemMaxNumberFreezeFrameRecords=0
          DemEventClass0 (DemEventClass):
            DemAgingAllowed = 0
            DemConsiderPtoStatus = 0
            DemEventOBDReadinessGroup = DEM_OBD_RDY_NONE
            DemEventPriority = 1
            DemFFPrestorageSupported = 0
            DemOperationCycleRef = DemOperationCycle0
            DemDebounceAlgorithmClass0 (DemDebounceAlgorithmClass)
        PWM_E_UNEXPECTED_IRQ: DemEventId=14, DemEventKind=DEM_EVENT_KIND_BSW, DemMaxNumberFreezeFrameRecords=0
          DemEventClass0 (DemEventClass):
            DemAgingAllowed = 0
            DemConsiderPtoStatus = 0
            DemEventOBDReadinessGroup = DEM_OBD_RDY_NONE
            DemEventPriority = 1
            DemFFPrestorageSupported = 0
            DemOperationCycleRef = DemOperationCycle0
            DemDebounceAlgorithmClass0 (DemDebounceAlgorithmClass)
        SPI_E_TIMEOUT: DemEventId=15, DemEventKind=DEM_EVENT_KIND_BSW, DemMaxNumberFreezeFrameRecords=0
          DemEventClass0 (DemEventClass):
            DemAgingAllowed = 0
            DemConsiderPtoStatus = 0
            DemEventOBDReadinessGroup = DEM_OBD_RDY_NONE
            DemEventPriority = 1
            DemFFPrestorageSupported = 0
            DemOperationCycleRef = DemOperationCycle0
            DemDebounceAlgorithmClass0 (DemDebounceAlgorithmClass)
        WDG_E_MODE_FAILED: DemEventId=16, DemEventKind=DEM_EVENT_KIND_BSW, DemMaxNumberFreezeFrameRecords=0
          DemEventClass0 (DemEventClass):
            DemAgingAllowed = 0
            DemConsiderPtoStatus = 0
            DemEventOBDReadinessGroup = DEM_OBD_RDY_NONE
            DemEventPriority = 1
            DemFFPrestorageSupported = 0
            DemOperationCycleRef = DemOperationCycle0
            DemDebounceAlgorithmClass0 (DemDebounceAlgorithmClass)
        WDG_E_DISABLE_REJECTED: DemEventId=17, DemEventKind=DEM_EVENT_KIND_BSW, DemMaxNumberFreezeFrameRecords=0
          DemEventClass0 (DemEventClass):
            DemAgingAllowed = 0
            DemConsiderPtoStatus = 0
            DemEventOBDReadinessGroup = DEM_OBD_RDY_NONE
            DemEventPriority = 1
            DemFFPrestorageSupported = 0
            DemOperationCycleRef = DemOperationCycle0
            DemDebounceAlgorithmClass0 (DemDebounceAlgorithmClass)
        WDG_E_MISS_TRIGGER: DemEventId=18, DemEventKind=DEM_EVENT_KIND_BSW, DemMaxNumberFreezeFrameRecords=0
          DemEventClass0 (DemEventClass):
            DemAgingAllowed = 0
            DemConsiderPtoStatus = 0
            DemEventOBDReadinessGroup = DEM_OBD_RDY_NONE
            DemEventPriority = 1
            DemFFPrestorageSupported = 0
            DemOperationCycleRef = DemOperationCycle0
            DemDebounceAlgorithmClass0 (DemDebounceAlgorithmClass)
        CANSM_E_MODE_CHANGE_PROJECT: DemEventId=68, DemEventKind=DEM_EVENT_KIND_BSW, DemMaxNumberFreezeFrameRecords=0
          DemCallbackEventStatusChanged0 (DemCallbackEventStatusChanged)
          DemEventClass:
            DemAgingAllowed = 0
            DemConsiderPtoStatus = 0
            DemFFPrestorageSupported = 0
            DemEventOBDReadinessGroup = DEM_OBD_RDY_NONE
            DemEventPriority = 1
            DemOperationCycleRef = DemOperationCycle0
        REGMON_E_REG_FAILURE: DemEventId=69, DemEventKind=DEM_EVENT_KIND_BSW
          DemEventClass:
            DemAgingAllowed = 0
            DemConsiderPtoStatus = 0
            DemFFPrestorageSupported = 0
            DemAgingCycleCounterThreshold = 1
            DemEventFailureCycleCounterThreshold = 1
            DemEventPriority = 1
            DemEventSignificance = DEM_EVENT_SIGNIFICANCE_OCCURRENCE
            DemOperationCycleRef = DemOperationCycle0
            DemAgingCycleRef = DemOperationCycle0
            DemDebounceAlgorithmClass
    DemGeneral0 (DemGeneral):
      DemAgingCycleCounterProcessing = DEM_PROCESS_AGINGCTR_INTERN
      DemBswErrorBufferSize = 25
      DemClearDTCBehavior = DEM_CLRRESP_NONVOLATILE_TRIGGER
      DemDTCSuppressionSupport = 0
      DemDebounceCounterBasedSupport = 1
      DemDebounceTimeBasedSupport = 1
      DemDevErrorDetect = 1
      DemDtcStatusAvailabilityMask = 0x89
      DemEnableConditionSupport = 1
      DemEventCombinationSupport = DEM_EVCOMB_DISABLED
      DemEventDisplacementSupport = 1
      DemExtendedDataCapture = DEM_TRIGGER_TESTFAILED
      DemFreezeFrameCapture = DEM_TRIGGER_TESTFAILED
      DemImmediateNvStorageLimit = 5
      DemMaxNumberEventEntryMirror = 0
      DemMaxNumberEventEntryPermanent = 0
      DemMaxNumberEventEntryPrimary = 3
      DemMaxNumberEventEntrySecondary = 0
      DemMaxNumberPrestoredFF = 0
      DemOBDSupport = 0
      DemOccurrenceCounterProcessing = DEM_PROCESS_OCCCTR_TF
      DemOperationCycleStatusStorage = 1
      DemPTOSupport = 0
      DemStatusBitHandlingTestFailedSinceLastClear = DEM_STATUS_BIT_NORMAL
      DemStatusBitStorageTestFailed = 0
      DemStorageConditionSupport = 0
      DemTaskTime = 0.01
      DemTriggerDcmReports = 0
      DemTriggerDltReports = 0
      DemTriggerFiMReports = 1
      DemTriggerMonitorInitBeforeClearOk = 0
      DemTypeOfDTCSupported = DEM_DTC_TRANSLATION_ISO15031_6
      DemTypeOfFreezeFrameRecordNumeration = DEM_FF_RECNUM_CALCULATED
      DemVersionInfoApi = 0
      DemAgingRequieresTestedCycle = 1
      DemHealingRequieresTestedCycle = 1
      DemNvRamBlockAccessOptimizationSupport = 1
      DemFimIntegrated = 1
      4 x DemDataElementClass:
        DE_0001
          DemExternalCSDataElementClass_0 (DemExternalCSDataElementClass): DemDataElementDataSize=3, DemDataElementUsePort=1
        DE_0002
          DemExternalCSDataElementClass_0 (DemExternalCSDataElementClass): DemDataElementDataSize=3, DemDataElementUsePort=1
        AgingCounter
          DemInternalDataElementClass: DemDataElementDataSize=1, DemInternalDataElement=DEM_AGINGCTR
        OccurrenceCounter
          DemInternalDataElementClass: DemDataElementDataSize=1, DemInternalDataElement=DEM_OCCCTR
      DemDidClass0 (DemDidClass): DemDidIdentifier=0x4710, DemDidDataElementClassRef=DE_0001/DemExternalCSDataElementClass_0
      DemDidClass1 (DemDidClass): DemDidIdentifier=0x4711, DemDidDataElementClassRef=DE_0002/DemExternalCSDataElementClass_0
      DemEnableCondition: DemEnableConditionId=0, DemEnableConditionStatus=1
      DemEnableConditionGroup: DemEnableConditionRef=DemEnableCondition
      4 x DemExtendedDataClass:
        ED_TEST_01: DemExtendedDataRecordClassRef=EDR_TEST_01
        ED_TEST_02: DemExtendedDataRecordClassRef=EDR_TEST_01, DemExtendedDataRecordClassRef=EDR_TEST_02
        ED_TEST_03: DemExtendedDataRecordClassRef=EDR_TEST_03
        ED_TEST_04: DemExtendedDataRecordClassRef=EDR_TEST_04
      4 x DemExtendedDataRecordClass, all with DemExtendedDataRecordUpdate=DEM_UPDATE_RECORD_YES:
        EDR_TEST_01: DemExtendedDataRecordNumber=5, DemDataElementClassRef=OccurrenceCounter/DemInternalDataElementClass
        EDR_TEST_02: DemExtendedDataRecordNumber=6, DemDataElementClassRef=AgingCounter/DemInternalDataElementClass
        EDR_TEST_03: DemExtendedDataRecordNumber=1, DemDataElementClassRef=DE_0001/DemExternalCSDataElementClass_0
        EDR_TEST_04: DemExtendedDataRecordNumber=1, DemDataElementClassRef=DE_0002/DemExternalCSDataElementClass_0
      DemFreezeFrameClass0 (DemFreezeFrameClass): DemDidClassRef=DemDidClass0
      DemFreezeFrameClass1 (DemFreezeFrameClass): DemDidClassRef=DemDidClass1
      4 x DemGroupOfDTC:
        DEM_DTC_GROUP_POWERTRAIN_DTCS: DemGroupDTCs=0xff
        DEM_DTC_GROUP_CHASSIS_DTCS: DemGroupDTCs=0x4000ff
        DEM_DTC_GROUP_BODY_DTCS: DemGroupDTCs=0x8000ff
        DEM_DTC_GROUP_NETWORK_COM_DTCS: DemGroupDTCs=0xc000ff
      DemIndicator_0 (DemIndicator): DemIndicatorID=0
      DemIndicator_1 (DemIndicator): DemIndicatorID=1
      DemNvRamBlockId
        DemManagementBlock: DemManagementBlockNvBlockIdRef=NvMBlock_DemNonVolatileData
        DemEventStatusNvRamBlock: DemEventStatusNvRamBlockIdRef=NvMBlock_DemEventStatusNvRamBlock
        3 x DemPrimaryEventMemory:
          DemPrimaryEventMemory{0..2}: DemPrimaryEventMemoryNvBlockIdRef=NvMBlock_DemPrimaryEventMemory_{0..2}
      DemOperationCycle0 (DemOperationCycle): DemOperationCycleType=DEM_OPCYC_POWER
