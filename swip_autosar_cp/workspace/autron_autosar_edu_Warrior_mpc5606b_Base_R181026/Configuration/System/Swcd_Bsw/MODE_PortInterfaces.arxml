AUTOSAR XML (schema 4-0-3)
package /MODE/ApplicationPrimitiveDataTypes
  app type ENUM_ComMMode: category=VALUE, compu {0=COMM_MODE_NO_COM, 2=COMM_MODE_FULL_COM}
  app type ENUM_PduRouter: category=VALUE, compu {0=PDU_ROUTER_ENABLE, 1=PDU_ROUTER_DISABLE}
  app type ENUM_AppMode: category=VALUE, compu {0=APP_MODE_ACTIVE, 1=APP_MODE_INACTIVE_OFF, 2=APP_MODE_INACTIVE_RESET, 3=APP_MODE_INACTIVE_SLEEP}
package /MODE/ModeDeclarationGroups
  7 x mode declaration group, all with category=EXPLICIT_ORDER, on-transition-value=255:
    MDG_ComMMode: initial-mode=MDG_ComMMode/NO_COM
      mode NO_COM: value=0
      mode SILENT_COM: value=1
      mode FULL_COM: value=2
    MDG_CanSMState: initial-mode=MDG_CanSMState/NO_COM
      5 x mode:
        NO_COM: value=0
        SILENT_COM: value=1
        FULL_COM: value=2
        BUS_OFF: value=3
        CHANGE_BAUDRATE: value=4
    MDG_CanSMBORState: initial-mode=MDG_CanSMBORState/COMPLETE
      mode COMPLETE: value=0
      mode START: value=1
    MDG_LinSMState: initial-mode=MDG_LinSMState/NO_COM
      mode NO_COM: value=0
      mode FULL_COM: value=1
    MDG_WakeupEvent: initial-mode=INITIAL_MODE
      9 x mode:
        POWER: value=0
        RESET: value=1
        INTERNAL_RESET: value=2
        INTERNAL_WDG: value=3
        EXTERNAL_WDG: value=4
        GPT: value=5
        CAN1RX: value=6
        CAN1RX_POLL: value=7
        INITIAL_MODE: value=32
    MDG_InitState: initial-mode=MDG_InitState/START
      mode START: value=0
      mode COMPLETE: value=1
    MDG_PduGroup: initial-mode=STOP
      mode STOP: value=0
      mode START: value=1
package /MODE/DataTypeMappingSets
  9 x data type mapping set:
    MAP_ComMMode: data-type-map{application-data-type=ENUM_ComMMode, implementation-data-type=uint8}, mode-request-type-map{implementation-data-type=uint8, mode-group=MDG_ComMMode}
    MAP_CanSMState: mode-request-type-map{implementation-data-type=uint8, mode-group=MDG_CanSMState}
    MAP_CanSMBORState: mode-request-type-map{implementation-data-type=uint8, mode-group=MDG_CanSMBORState}
    MAP_LinSMState: mode-request-type-map{implementation-data-type=uint8, mode-group=MDG_LinSMState}
    MAP_WakeupEvent: mode-request-type-map{implementation-data-type=uint8, mode-group=MDG_WakeupEvent}
    MAP_PduRouter: data-type-map{application-data-type=ENUM_PduRouter, implementation-data-type=uint8}
    MAP_InitState: mode-request-type-map{implementation-data-type=uint8, mode-group=MDG_InitState}
    MAP_AppMode: data-type-map{application-data-type=ENUM_AppMode, implementation-data-type=uint8}
    MAP_PduGroup: mode-request-type-map{implementation-data-type=uint8, mode-group=MDG_PduGroup}
package /MODE/SenderReceiverInterfaces
  sender receiver interface PduRouterRequestInterface: is-service=true, service-kind=BASIC-SOFTWARE-MODE-MANAGER
    data PduRouter_Test: type=ENUM_PduRouter
  sender receiver interface AppModeRequestInterface: is-service=true, service-kind=BASIC-SOFTWARE-MODE-MANAGER
    data AppMode: type=ENUM_AppMode
package /MODE/ModeSwitchInterfaces
  mode switch interface WakeupEventInterface: is-service=true, service-kind=BASIC-SOFTWARE-MODE-MANAGER
    mode group WakeupEvent: type=MDG_WakeupEvent
  mode switch interface InitStateInterface: is-service=true, service-kind=BASIC-SOFTWARE-MODE-MANAGER
    mode group InitState: type=MDG_InitState
  mode switch interface EcuModeInterface: is-service=true, service-kind=BASIC-SOFTWARE-MODE-MANAGER
    mode group EcuMode: type=EcuMode
package /MODE_Project/ModeSwitchInterfaces
  5 x mode switch interface, all with is-service=true, service-kind=BASIC-SOFTWARE-MODE-MANAGER:
    CanSMBORStateInterface_Project
      mode group CanSMBORState_Project: type=MDG_CanSMBORState
    CanSMStateInterface_Project
      mode group CanSMState_Project: type=MDG_CanSMState
    ComMModeInterface_Project
      mode group ComMMode_Project: type=MDG_ComMMode
    PduGroupTxInterface_Project
      mode group PduGroupTx_Project: type=MDG_PduGroup
    PduGroupRxInterface_Project
      mode group PduGroupRx_Project: type=MDG_PduGroup
package /MODE_Project/SenderReceiverInterfaces
  sender receiver interface ComMModeRequestInterface_Project: is-service=true, service-kind=BASIC-SOFTWARE-MODE-MANAGER
    data ComMMode_Project: type=ENUM_ComMMode
