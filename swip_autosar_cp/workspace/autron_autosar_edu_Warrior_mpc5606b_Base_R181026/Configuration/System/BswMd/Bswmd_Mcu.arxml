AUTOSAR XML (schema 4-0-3)
package /AUTOSAR_Mcu/BswModuleDescriptions
  bsw module description Mcu: module-id=101
    provided-entrys:
      Mcu_Disable_ClockOutput
      Mcu_Disable_CMU
      Mcu_DistributePllClock
      Mcu_eMios_Configure_GPREN
      Mcu_EMIOS_Init
      Mcu_Enable_ClockOutput
      Mcu_GetDeviceInfo
      Mcu_GetPllStatus
      Mcu_GetRamState
      Mcu_GetResetRawValue
      Mcu_GetResetReason
      Mcu_GetVersionInfo
      Mcu_Init
      Mcu_InitClock
      Mcu_InitRamSection
      Mcu_PerformReset
      Mcu_SetMode
      Mcu_SscmGetMemConfig
      Mcu_SscmGetStatus
      Mcu_SscmGetUops
      Mcu_EnterSafeMode_ISR
      Mcu_InvalidConfig_ISR
      Mcu_InvalidMode_ISR
      Mcu_TransitionComplete_ISR
      Mcu_XOSC_ISR
      RGM_AlternateMode_ISR
    bsw internal behavior InternalBehavior_Mcu
      4 x exclusive area:
        MCU_EXCLUSIVE_AREA_{00..03}
      20 x bsw called entity:
        Mcu_Disable_ClockOutput: implemented-entry=Mcu_Disable_ClockOutput
        Mcu_Disable_CMU: implemented-entry=Mcu_Disable_CMU
        Mcu_DistributePllClock: implemented-entry=Mcu_DistributePllClock
        Mcu_eMios_Configure_GPREN: implemented-entry=Mcu_eMios_Configure_GPREN
        Mcu_EMIOS_Init: implemented-entry=Mcu_EMIOS_Init
        Mcu_Enable_ClockOutput: implemented-entry=Mcu_Enable_ClockOutput
        Mcu_GetDeviceInfo: implemented-entry=Mcu_GetDeviceInfo
        Mcu_GetPllStatus: implemented-entry=Mcu_GetPllStatus
        Mcu_GetRamState: implemented-entry=Mcu_GetRamState
        Mcu_GetResetRawValue: implemented-entry=Mcu_GetResetRawValue
        Mcu_GetResetReason: implemented-entry=Mcu_GetResetReason
        Mcu_GetVersionInfo: implemented-entry=Mcu_GetVersionInfo
        Mcu_Init: can-enter-exclusive-area=[MCU_EXCLUSIVE_AREA_00, MCU_EXCLUSIVE_AREA_01, MCU_EXCLUSIVE_AREA_02, MCU_EXCLUSIVE_AREA_03], implemented-entry=Mcu_Init
        Mcu_InitClock: implemented-entry=Mcu_InitClock
        Mcu_InitRamSection: implemented-entry=Mcu_InitRamSection
        Mcu_PerformReset: implemented-entry=Mcu_PerformReset
        Mcu_SetMode: implemented-entry=Mcu_SetMode
        Mcu_SscmGetMemConfig: implemented-entry=Mcu_SscmGetMemConfig
        Mcu_SscmGetStatus: implemented-entry=Mcu_SscmGetStatus
        Mcu_SscmGetUops: implemented-entry=Mcu_SscmGetUops
      6 x bsw interrupt entity, all with interrupt-category=CAT-2, interrupt-source=Hardware:
        Mcu_EnterSafeMode_ISR: implemented-entry=Mcu_EnterSafeMode_ISR
        Mcu_InvalidConfig_ISR: implemented-entry=Mcu_InvalidConfig_ISR
        Mcu_InvalidMode_ISR: implemented-entry=Mcu_InvalidMode_ISR
        Mcu_TransitionComplete_ISR: implemented-entry=Mcu_TransitionComplete_ISR
        Mcu_XOSC_ISR: implemented-entry=Mcu_XOSC_ISR
        RGM_AlternateMode_ISR: implemented-entry=RGM_AlternateMode_ISR
package /AUTOSAR_Mcu/BswModuleEntrys
  26 x bsw module entry, all with is-synchronous=true, sw-service-impl-policy=STANDARD:
    Mcu_Disable_ClockOutput: service-id=0, is-reentrant=false, call-type=REGULAR, execution-context=UNSPECIFIED
    Mcu_Disable_CMU: service-id=0, is-reentrant=false, call-type=REGULAR, execution-context=UNSPECIFIED
    Mcu_DistributePllClock: service-id=0x03, is-reentrant=false, call-type=REGULAR, execution-context=UNSPECIFIED
    Mcu_eMios_Configure_GPREN: service-id=0, is-reentrant=false, call-type=REGULAR, execution-context=UNSPECIFIED
    Mcu_EMIOS_Init: service-id=0, is-reentrant=false, call-type=REGULAR, execution-context=UNSPECIFIED
    Mcu_Enable_ClockOutput: service-id=0, is-reentrant=false, call-type=REGULAR, execution-context=UNSPECIFIED
    Mcu_GetDeviceInfo: service-id=0, is-reentrant=false, call-type=REGULAR, execution-context=UNSPECIFIED
    Mcu_GetPllStatus: service-id=0x04, is-reentrant=true, call-type=REGULAR, execution-context=UNSPECIFIED
    Mcu_GetRamState: service-id=0x04, is-reentrant=true, call-type=REGULAR, execution-context=UNSPECIFIED
    Mcu_GetResetRawValue: service-id=0x06, is-reentrant=true, call-type=REGULAR, execution-context=UNSPECIFIED
    Mcu_GetResetReason: service-id=0x05, is-reentrant=true, call-type=REGULAR, execution-context=UNSPECIFIED
    Mcu_GetVersionInfo: service-id=0x09, is-reentrant=true, call-type=REGULAR, execution-context=UNSPECIFIED
    Mcu_Init: service-id=0x00, is-reentrant=false, call-type=REGULAR, execution-context=UNSPECIFIED
    Mcu_InitClock: service-id=0x02, is-reentrant=false, call-type=REGULAR, execution-context=UNSPECIFIED
    Mcu_InitRamSection: service-id=0x01, is-reentrant=false, call-type=REGULAR, execution-context=UNSPECIFIED
    Mcu_PerformReset: service-id=0x07, is-reentrant=false, call-type=REGULAR, execution-context=UNSPECIFIED
    Mcu_SetMode: service-id=0x08, is-reentrant=false, call-type=REGULAR, execution-context=UNSPECIFIED
    Mcu_SscmGetMemConfig: service-id=0, is-reentrant=false, call-type=REGULAR, execution-context=UNSPECIFIED
    Mcu_SscmGetStatus: service-id=0, is-reentrant=false, call-type=REGULAR, execution-context=UNSPECIFIED
    Mcu_SscmGetUops: service-id=0, is-reentrant=false, call-type=REGULAR, execution-context=UNSPECIFIED
    Mcu_EnterSafeMode_ISR: service-id=0, is-reentrant=false, call-type=INTERRUPT, execution-context=INTERRUPT-CAT-2
    Mcu_InvalidConfig_ISR: service-id=0, is-reentrant=false, call-type=INTERRUPT, execution-context=INTERRUPT-CAT-2
    Mcu_InvalidMode_ISR: service-id=0, is-reentrant=false, call-type=INTERRUPT, execution-context=INTERRUPT-CAT-2
    Mcu_TransitionComplete_ISR: service-id=0, is-reentrant=false, call-type=INTERRUPT, execution-context=INTERRUPT-CAT-2
    Mcu_XOSC_ISR: service-id=0, is-reentrant=false, call-type=INTERRUPT, execution-context=INTERRUPT-CAT-2
    RGM_AlternateMode_ISR: service-id=0, is-reentrant=false, call-type=INTERRUPT, execution-context=INTERRUPT-CAT-2
package /Mcu_T2D13M10I1R0/Implementations
  bsw implementation BswImplementation_Mcu: programming-language=C, sw-version=1.0.1, vendor-id=43, ar-release-version=4.0.3, behavior=InternalBehavior_Mcu, vendor-specific-module-def=Mcu
    code-descriptors:
      code Files
        artifact-descriptors:
          short-label=config::Mcu.xdm, category=SWCFG
          short-label=config_ext::McuPreConfiguration.xdm, category=SWCFG
          short-label=doc::AUTOSAR_MCAL_MCU_IM.pdf, category=SWDOC
          short-label=doc::AUTOSAR_MCAL_MCU_UM.pdf, category=SWDOC
          short-label=include::Dmamux_LLD.h, category=SWHDR
          short-label=include::Dma_LLD.h, category=SWHDR
          short-label=include::Mcu.h, category=SWHDR
          short-label=include::Mcu_Ecsm_LLD.h, category=SWHDR
          short-label=include::Mcu_eMIOS_LLD.h, category=SWHDR
          short-label=include::Mcu_LLD.h, category=SWHDR
          short-label=include::Mcu_NonASR.h, category=SWHDR
          short-label=include::Mcu_Siul_LLD.h, category=SWHDR
          short-label=include::Mcu_Sscm_LLD.h, category=SWHDR
          short-label=include::Mcu_SSCM_Types.h, category=SWHDR
          short-label=include::Reg_eSys_DMA.h, category=SWHDR
          short-label=include::Reg_eSys_DMAMUX.h, category=SWHDR
          short-label=include::Reg_eSys_ECSM.h, category=SWHDR
          short-label=include::Reg_eSys_EMIOS.h, category=SWHDR
          short-label=include::Reg_eSys_FLASHC.h, category=SWHDR
          short-label=include::Reg_eSys_SIUL.h, category=SWHDR
          short-label=include::Reg_eSys_SSCM.h, category=SWHDR
          short-label=src::Mcu.c, category=SWSRC
          short-label=src::Mcu_Dma_LLD.c, category=SWSRC
          short-label=src::Mcu_Ecsm_LLD.c, category=SWSRC
          short-label=src::Mcu_eMIOS_LLD.c, category=SWSRC
          short-label=src::Mcu_Flash_LLD.c, category=SWSRC
          short-label=src::Mcu_Irq.c, category=SWSRC
          short-label=src::Mcu_LLD.c, category=SWSRC
          short-label=src::Mcu_NonASR.c, category=SWSRC
          short-label=src::Mcu_Reg_eSys_EMIOS.c, category=SWSRC
          short-label=src::Mcu_Siul_LLD.c, category=SWSRC
          short-label=src::Mcu_Sscm_LLD.c, category=SWSRC
    4 x compiler:
      CW_Compiler:
        name=CodeWarrior for MPC5xxx
        options=-proc Zen -lang c -opt all -common off -sdatathreshold 0 -sdata2threshold 0 -vle -use_lmw_stmw on -ppc_asm_to_vle -Cpp_exceptions off -func_align 4 -sym dwarf-2,full -gdwarf-2 -w on -r -w undefmacro -char unsigned -nosyspath -fp none -DAUTOSAR_OS_NOT_USED -DMWERKS
        vendor=Freescale Semiconductor
        version=Freescale CodeWarrior for MPC5xxx v2.10 - compiler Version 4.3 build 224
      HT_Compiler: name=Hi-Tech C Compiler, options=-Os -msdata=eabi -G1000 -fshort-double -mno-spe -mregnames -g3 -Wall -mvle --mcpu=z425n3 -DAUTOSAR_OS_NOT_USED -DUSE_SW_VECTOR_MODE, vendor=HiTech, version=HighTec v4.6.4.0, Compiler gcc v4.6.3
      DIAB_Compiler:
        name=Windriver Diab
        options=-Xdialect-ansi -XO -g -Xsize-opt -Xsmall-data=0 -Xaddr-sconst=0x11 -Xaddr-sdata=0x11 -Xno-common -Xnested-interrupts -Xdebug-dwarf2 -Xdebug-local-all -Xdebug-local-cie -Xdebug-struct-all -Xforce-declarations -ee1481 -Xmacro-undefined-warn -W:as:,-l -Wa,-Xisa-vle -DAUTOSAR_OS_NOT_USED -DDIAB -Xforce-prototypes -tPPCE200Z0VEN:simple
        vendor=Windriver
        version=Windriver DIAB Rel DIAB_5_9_2_0-FCS_20120725_234511
      GHS_Compiler: name=Green Hills, options=-cpu=ppc560xb -ansi -noSPE -Ospace -sda=0 -vle -dual_debug -G --no_exceptions -Wundef -Wimplicit-int -Wshadow -Wtrigraphs --prototype_errors --incorrect_pragma_warnings -noslashcomment -preprocess_assembly_files --short_enum --no_commons -c -DAUTOSAR_OS_NOT_USED -DUSE_SW_VECTOR_MODE -DDISABLE_MCAL_INTERMODULE_ASR_CHECK -DGHS, vendor=Green Hills, version=Green Hills MULTI v6.1.4
    generated-artifacts:
      10 x dependency on artifact, all with usages=COMPILE:
        Mcu_Dmamux_LLD_c: artifact-descriptor={short-label=generate::src::Mcu_Dmamux_LLD.c, category=SWSRC}
        Mcu_MC_Clocks_LLD_c: artifact-descriptor={short-label=generate::src::Mcu_MC_Clocks_LLD.c, category=SWSRC}
        Mcu_MC_Modes_LLD_c: artifact-descriptor={short-label=generate::src::Mcu_MC_Modes_LLD.c, category=SWSRC}
        Mcu_MC_Monitor_LLD_c: artifact-descriptor={short-label=generate::src::Mcu_MC_Monitor_LLD.c, category=SWSRC}
        Mcu_MC_Power_LLD_c: artifact-descriptor={short-label=generate::src::Mcu_MC_Power_LLD.c, category=SWSRC}
        Mcu_MC_Reset_LLD_c: artifact-descriptor={short-label=generate::src::Mcu_MC_Reset_LLD.c, category=SWSRC}
        Mcu_PBcfg_c: artifact-descriptor={short-label=generate_PB::src::Mcu_PBcfg.c, category=SWSRC}
        Mcu_Cfg_h: artifact-descriptor={short-label=generate_PC::include::Mcu_Cfg.h, category=SWHDR}
        Reg_eSys_MagicCarpet_h: artifact-descriptor={short-label=generate_PC::include::Reg_eSys_MagicCarpet.h, category=SWHDR}
        Mcu_Cfg_c: artifact-descriptor={short-label=generate_PC::src::Mcu_Cfg.c, category=SWSRC}
    4 x linker:
      CW_Linker: name=CodeWarrior for MPC5xxx, options=-proc Zen -code_merging all -far_near_addressing -vle_enhance_merging -listdwarf -sym dwarf-2,full -char unsigned, vendor=Freescale Semiconductor, version=Freescale CodeWarrior for MPC5xxx v2.10 - compiler Version 4.3 build 224
      HT_Linker: name=Hi-Tech C Compiler, options=-N --no-undefined --warn-common --error-unresolved-symbols -nocrt0 -nostartfiles -Wl --no-warn-flags -T, vendor=HiTech, version=HighTec v4.6.4.0, Compiler gcc v4.6.3
      DIAB_Linker: name=Windriver Diab, options=-tPPCE200Z0VEN:simple -Xelf -m6 -lc -Xlibc-old, vendor=Windriver, version=Windriver DIAB Rel DIAB_5_9_2_0-FCS_20120725_234511
      GHS_Linker: name=Green Hills, options=-cpu=ppc560xb -nostartfiles -vle -linker_warnings, vendor=Green Hills, version=Green Hills MULTI v6.1.4
    resource consumption ResourceConsumption
      7 x memory section:
        MCU_CODE: alignment=UNSPECIFIED, sw-addrmethod=CODE, symbol=CODE
        MCU_CONFIG_DATA_UNSPECIFIED: alignment=UNSPECIFIED, sw-addrmethod=CONFIG_DATA_UNSPECIFIED, symbol=CONFIG_DATA_UNSPECIFIED
        MCU_CONST_32: alignment=32, sw-addrmethod=CONST_32, symbol=CONST_32
        MCU_RAMCODE: alignment=UNSPECIFIED, sw-addrmethod=RAMCODE, symbol=RAMCODE
        MCU_VAR_INIT_UNSPECIFIED: alignment=UNSPECIFIED, sw-addrmethod=VAR_INIT_UNSPECIFIED, symbol=VAR_INIT_UNSPECIFIED
        MCU_VAR_NO_INIT_32: alignment=32, sw-addrmethod=VAR_NO_INIT_32, symbol=VAR_NO_INIT_32
        MCU_VAR_NO_INIT_UNSPECIFIED: alignment=UNSPECIFIED, sw-addrmethod=VAR_NO_INIT_UNSPECIFIED, symbol=VAR_NO_INIT_UNSPECIFIED
