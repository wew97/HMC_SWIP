AUTOSAR XML (schema 4-0-3)
package /Bsw_Crc
  bsw implementation BswImplementation_Crc: programming-language=C, sw-version=1.0.0, vendor-id=76, ar-release-version=4.0.3, behavior=BswInternalBehavior_19
  bsw module description Crc: module-id=201
    bsw internal behavior BswInternalBehavior_19
