AUTOSAR XML (schema 4-0-3)
package /AUTOSAR_Wdg_43/BswModuleDescriptions
  bsw module description Wdg: module-id=102
    provided-entrys:
      Wdg_ChannelGetVersionInfo
      Wdg_ChannelInit
      Wdg_ChannelSetMode
      Wdg_ChannelSetTriggerCondition
      Wdg_Cbk_GptNotification
      Wdg_GetVersionInfo
      Wdg_Init
      Wdg_SetMode
      Wdg_SetTriggerCondition
      Wdg_Isr0
    bsw internal behavior BswInternalBehavior_Wdg_43
      exclusive area WDG_EXCLUSIVE_AREA_00
      9 x bsw called entity, all with can-enter-exclusive-area=WDG_EXCLUSIVE_AREA_00:
        Wdg_ChannelGetVersionInfo: implemented-entry=Wdg_ChannelGetVersionInfo
        Wdg_ChannelInit: implemented-entry=Wdg_ChannelInit
        Wdg_ChannelSetMode: implemented-entry=Wdg_ChannelSetMode
        Wdg_ChannelSetTriggerCondition: implemented-entry=Wdg_ChannelSetTriggerCondition
        Wdg_Cbk_GptNotification: implemented-entry=Wdg_Cbk_GptNotification
        Wdg_GetVersionInfo: implemented-entry=Wdg_GetVersionInfo
        Wdg_Init: implemented-entry=Wdg_Init
        Wdg_SetMode: implemented-entry=Wdg_SetMode
        Wdg_SetTriggerCondition: implemented-entry=Wdg_SetTriggerCondition
      bsw interrupt entity Wdg_Isr0: can-enter-exclusive-area=WDG_EXCLUSIVE_AREA_00, implemented-entry=Wdg_Isr0, interrupt-category=CAT-2, interrupt-source=Hardware
package /AUTOSAR_Wdg_43/BswModuleEntrys
  10 x bsw module entry, all with is-synchronous=true, sw-service-impl-policy=STANDARD:
    Wdg_ChannelGetVersionInfo: service-id=0, is-reentrant=false, call-type=REGULAR, execution-context=UNSPECIFIED
    Wdg_ChannelInit: service-id=0, is-reentrant=false, call-type=REGULAR, execution-context=UNSPECIFIED
    Wdg_ChannelSetMode: service-id=0, is-reentrant=false, call-type=REGULAR, execution-context=UNSPECIFIED
    Wdg_ChannelSetTriggerCondition: service-id=0, is-reentrant=false, call-type=REGULAR, execution-context=UNSPECIFIED
    Wdg_Cbk_GptNotification: service-id=0x05, is-reentrant=false, call-type=REGULAR, execution-context=UNSPECIFIED
    Wdg_GetVersionInfo: service-id=0x04, is-reentrant=true, call-type=REGULAR, execution-context=UNSPECIFIED
    Wdg_Init: service-id=0x00, is-reentrant=false, call-type=REGULAR, execution-context=UNSPECIFIED
    Wdg_SetMode: service-id=0x01, is-reentrant=false, call-type=REGULAR, execution-context=UNSPECIFIED
    Wdg_SetTriggerCondition: service-id=0x03, is-reentrant=false, call-type=REGULAR, execution-context=UNSPECIFIED
    Wdg_Isr0: service-id=0, is-reentrant=false, call-type=INTERRUPT, execution-context=INTERRUPT-CAT-2
package /Wdg_T2D13M10I1R0/Implementations
  bsw implementation BswImplementation_Wdg_43: programming-language=C, sw-version=1.0.1, vendor-id=43, ar-release-version=4.0.3, behavior=BswInternalBehavior_Wdg_43, vendor-specific-module-def=Wdg
    code-descriptors:
      code Files
        artifact-descriptors:
          short-label=config::Wdg.xdm, category=SWCFG
          short-label=doc::AUTOSAR_MCAL_WDG_IM.pdf, category=SWDOC
          short-label=doc::AUTOSAR_MCAL_WDG_UM.pdf, category=SWDOC
          short-label=include::Reg_eSys_Swt.h, category=SWHDR
          short-label=include::Wdg.h, category=SWHDR
          short-label=include::Wdg_Cbk.h, category=SWHDR
          short-label=include::Wdg_Channel.h, category=SWHDR
          short-label=include::Wdg_LLD.h, category=SWHDR
          short-label=include::Wdg_Swt_LLD.h, category=SWHDR
          short-label=src::Wdg_Channel.c, category=SWSRC
          short-label=src::Wdg_Irq.c, category=SWSRC
          short-label=src::Wdg_LLD.c, category=SWSRC
          short-label=src::Wdg_Swt_LLD.c, category=SWSRC
    4 x compiler:
      CW_Compiler:
        name=CodeWarrior for MPC5xxx
        options=-proc Zen -lang c -opt all -common off -sdatathreshold 0 -sdata2threshold 0 -vle -use_lmw_stmw on -ppc_asm_to_vle -Cpp_exceptions off -func_align 4 -sym dwarf-2,full -gdwarf-2 -w on -r -w undefmacro -char unsigned -nosyspath -fp none -DAUTOSAR_OS_NOT_USED -DMWERKS
        vendor=Freescale Semiconductor
        version=Freescale CodeWarrior for MPC5xxx v2.10 - compiler Version 4.3 build 224
      HT_Compiler: name=Hi-Tech C Compiler, options=-Os -msdata=eabi -G1000 -fshort-double -mno-spe -mregnames -g3 -Wall -mvle --mcpu=z425n3 -DAUTOSAR_OS_NOT_USED -DUSE_SW_VECTOR_MODE, vendor=HiTech, version=HighTec v4.6.4.0, Compiler gcc v4.6.3
      DIAB_Compiler:
        name=Windriver Diab
        options=-Xdialect-ansi -XO -g -Xsize-opt -Xsmall-data=0 -Xaddr-sconst=0x11 -Xaddr-sdata=0x11 -Xno-common -Xnested-interrupts -Xdebug-dwarf2 -Xdebug-local-all -Xdebug-local-cie -Xdebug-struct-all -Xforce-declarations -ee1481 -Xmacro-undefined-warn -W:as:,-l -Wa,-Xisa-vle -DAUTOSAR_OS_NOT_USED -DDIAB -Xforce-prototypes -tPPCE200Z0VEN:simple
        vendor=Windriver
        version=Windriver DIAB Rel DIAB_5_9_2_0-FCS_20120725_234511
      GHS_Compiler: name=Green Hills, options=-cpu=ppc560xb -ansi -noSPE -Ospace -sda=0 -vle -dual_debug -G --no_exceptions -Wundef -Wimplicit-int -Wshadow -Wtrigraphs --prototype_errors --incorrect_pragma_warnings -noslashcomment -preprocess_assembly_files --short_enum --no_commons -c -DAUTOSAR_OS_NOT_USED -DUSE_SW_VECTOR_MODE -DDISABLE_MCAL_INTERMODULE_ASR_CHECK -DGHS, vendor=Green Hills, version=Green Hills MULTI v6.1.4
    generated-artifacts:
      5 x dependency on artifact, all with usages=COMPILE:
        Wdg_Cfg_h: artifact-descriptor={short-label=generate::include::Wdg_Cfg.h, category=SWHDR}
        Wdg_CfgExt_c: artifact-descriptor={short-label=generate::src::Wdg_CfgExt.c, category=SWSRC}
        Wdg_43_Instance0_Lcfg_c: artifact-descriptor={short-label=generate_LT::src::Wdg_43_Instance0_Lcfg.c, category=SWSRC}
        Wdg_43_Instance0_PBCfg_c: artifact-descriptor={short-label=generate_PB::src::Wdg_43_Instance0_PBCfg.c, category=SWSRC}
        Wdg_43_Instance0_Cfg_c: artifact-descriptor={short-label=generate_PC::src::Wdg_43_Instance0_Cfg.c, category=SWSRC}
    4 x linker:
      CW_Linker: name=CodeWarrior for MPC5xxx, options=-proc Zen -code_merging all -far_near_addressing -vle_enhance_merging -listdwarf -sym dwarf-2,full -char unsigned, vendor=Freescale Semiconductor, version=Freescale CodeWarrior for MPC5xxx v2.10 - compiler Version 4.3 build 224
      HT_Linker: name=Hi-Tech C Compiler, options=-N --no-undefined --warn-common --error-unresolved-symbols -nocrt0 -nostartfiles -Wl --no-warn-flags -T, vendor=HiTech, version=HighTec v4.6.4.0, Compiler gcc v4.6.3
      DIAB_Linker: name=Windriver Diab, options=-tPPCE200Z0VEN:simple -Xelf -m6 -lc -Xlibc-old, vendor=Windriver, version=Windriver DIAB Rel DIAB_5_9_2_0-FCS_20120725_234511
      GHS_Linker: name=Green Hills, options=-cpu=ppc560xb -nostartfiles -vle -linker_warnings, vendor=Green Hills, version=Green Hills MULTI v6.1.4
    resource consumption ResourceConsumption
      7 x memory section:
        WDG_CODE: alignment=UNSPECIFIED, sw-addrmethod=CODE, symbol=CODE
        WDG_CONFIG_DATA_UNSPECIFIED: alignment=UNSPECIFIED, sw-addrmethod=CONFIG_DATA_UNSPECIFIED, symbol=CONFIG_DATA_UNSPECIFIED
        WDG_CONST_32: alignment=32, sw-addrmethod=CONST_32, symbol=CONST_32
        WDG_RAMCODE: alignment=UNSPECIFIED, sw-addrmethod=RAMCODE, symbol=RAMCODE
        WDG_VAR_INIT_32: alignment=32, sw-addrmethod=VAR_INIT_32, symbol=VAR_INIT_32
        WDG_VAR_INIT_UNSPECIFIED: alignment=UNSPECIFIED, sw-addrmethod=VAR_INIT_UNSPECIFIED, symbol=VAR_INIT_UNSPECIFIED
        WDG_VAR_NO_INIT_UNSPECIFIED: alignment=UNSPECIFIED, sw-addrmethod=VAR_NO_INIT_UNSPECIFIED, symbol=VAR_NO_INIT_UNSPECIFIED
