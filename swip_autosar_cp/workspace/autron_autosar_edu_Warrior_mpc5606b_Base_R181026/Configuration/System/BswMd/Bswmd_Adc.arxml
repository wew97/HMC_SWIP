AUTOSAR XML (schema 4-0-3)
package /AUTOSAR_Adc/BswModuleDescriptions
  bsw module description Adc: module-id=123
    provided-entrys:
      Adc_BCtuSetMode
      Adc_BCtuStartSoftwareTrigger
      Adc_ConfigureThreshold
      Adc_CTU2TriggerHandlerCtrlRegsEnableDisable
      Adc_DeInit
      Adc_DisableChannel
      Adc_DisableCtuTrigger
      Adc_DisableGroupNotification
      Adc_DisableHardwareTrigger
      Adc_DMAEndGroupConversion
      Adc_DMAEndInjectedConv
      Adc_DMAEndNormalConv
      Adc_EnableChannel
      Adc_EnableCtuTrigger
      Adc_EnableGroupNotification
      Adc_EnableHardwareTrigger
      Adc_EndCTUConv
      Adc_EndGroupConversion
      Adc_EndInjectedConv
      Adc_EndMultipleCTUConv
      Adc_EndNormalConv
      Adc_EndSwInjectedConv
      Adc_EndWDGInterrupt
      Adc_GetCTU2DmaLastSampleIndex
      Adc_GetGroupStatus
      Adc_GetInjectedConversionStatus
      Adc_GetStreamLastPointer
      Adc_GetVersionInfo
      Adc_GroupGetLastSamples
      Adc_GroupUpdateNumberSamples
      Adc_HwResultReadGroup
      Adc_Init
      Adc_ReadGroup
      Adc_ReadGroupSampleResult
      Adc_SetClockMode
      Adc_SetCTU2CmdListHandlerCtrlRegs
      Adc_SetCTU2TriggerCompareRegs
      Adc_SetCTU2TriggerHandlerCtrlRegs
      Adc_SetMode
      Adc_SetupResultBuffer
      Adc_StartGroupConversion
      Adc_StopGroupConversion
      Adc_WDGThresholdHandler
      Adc_DMAEndGroupConvUnit0
      Adc_DMAEndGroupConvUnit1
      Adc_EndGroupConvUnit0
      Adc_EndGroupConvUnit1
      Adc_WatchDogThresholdUnit0
      Adc_WatchDogThresholdUnit1
    bsw internal behavior InternalBehavior_Adc
      27 x exclusive area:
        ADC_EXCLUSIVE_AREA_{00..26}
      43 x bsw called entity:
        Adc_BCtuSetMode: implemented-entry=Adc_BCtuSetMode
        Adc_BCtuStartSoftwareTrigger: implemented-entry=Adc_BCtuStartSoftwareTrigger
        Adc_ConfigureThreshold: implemented-entry=Adc_ConfigureThreshold
        Adc_CTU2TriggerHandlerCtrlRegsEnableDisable: implemented-entry=Adc_CTU2TriggerHandlerCtrlRegsEnableDisable
        Adc_DeInit: implemented-entry=Adc_DeInit
        Adc_DisableChannel: implemented-entry=Adc_DisableChannel
        Adc_DisableCtuTrigger: implemented-entry=Adc_DisableCtuTrigger
        Adc_DisableGroupNotification: implemented-entry=Adc_DisableGroupNotification
        Adc_DisableHardwareTrigger: implemented-entry=Adc_DisableHardwareTrigger
        Adc_DMAEndGroupConversion: implemented-entry=Adc_DMAEndGroupConversion
        Adc_DMAEndInjectedConv: implemented-entry=Adc_DMAEndInjectedConv
        Adc_DMAEndNormalConv: implemented-entry=Adc_DMAEndNormalConv
        Adc_EnableChannel: implemented-entry=Adc_EnableChannel
        Adc_EnableCtuTrigger: implemented-entry=Adc_EnableCtuTrigger
        Adc_EnableGroupNotification: implemented-entry=Adc_EnableGroupNotification
        Adc_EnableHardwareTrigger: implemented-entry=Adc_EnableHardwareTrigger
        Adc_EndCTUConv: implemented-entry=Adc_EndCTUConv
        Adc_EndGroupConversion: implemented-entry=Adc_EndGroupConversion
        Adc_EndInjectedConv: implemented-entry=Adc_EndInjectedConv
        Adc_EndMultipleCTUConv: implemented-entry=Adc_EndMultipleCTUConv
        Adc_EndNormalConv: implemented-entry=Adc_EndNormalConv
        Adc_EndSwInjectedConv: implemented-entry=Adc_EndSwInjectedConv
        Adc_EndWDGInterrupt: implemented-entry=Adc_EndWDGInterrupt
        Adc_GetCTU2DmaLastSampleIndex: implemented-entry=Adc_GetCTU2DmaLastSampleIndex
        Adc_GetGroupStatus: implemented-entry=Adc_GetGroupStatus
        Adc_GetInjectedConversionStatus: implemented-entry=Adc_GetInjectedConversionStatus
        Adc_GetStreamLastPointer: implemented-entry=Adc_GetStreamLastPointer
        Adc_GetVersionInfo: implemented-entry=Adc_GetVersionInfo
        Adc_GroupGetLastSamples: implemented-entry=Adc_GroupGetLastSamples
        Adc_GroupUpdateNumberSamples: implemented-entry=Adc_GroupUpdateNumberSamples
        Adc_HwResultReadGroup: implemented-entry=Adc_HwResultReadGroup
        Adc_Init: can-enter-exclusive-area=[ADC_EXCLUSIVE_AREA_00, ADC_EXCLUSIVE_AREA_01, ADC_EXCLUSIVE_AREA_02, ADC_EXCLUSIVE_AREA_03, ADC_EXCLUSIVE_AREA_04, ADC_EXCLUSIVE_AREA_05, ADC_EXCLUSIVE_AREA_06, ADC_EXCLUSIVE_AREA_07, ADC_EXCLUSIVE_AREA_08, ADC_EXCLUSIVE_AREA_09, ADC_EXCLUSIVE_AREA_10, ADC_EXCLUSIVE_AREA_11, ADC_EXCLUSIVE_AREA_12, ADC_EXCLUSIVE_AREA_13, ADC_EXCLUSIVE_AREA_14, ADC_EXCLUSIVE_AREA_15, ADC_EXCLUSIVE_AREA_16, ADC_EXCLUSIVE_AREA_17, ADC_EXCLUSIVE_AREA_18, ADC_EXCLUSIVE_AREA_19, ADC_EXCLUSIVE_AREA_20, ADC_EXCLUSIVE_AREA_21, ADC_EXCLUSIVE_AREA_22, ADC_EXCLUSIVE_AREA_23, ADC_EXCLUSIVE_AREA_24, ADC_EXCLUSIVE_AREA_25, ADC_EXCLUSIVE_AREA_26], implemented-entry=Adc_Init
        Adc_ReadGroup: implemented-entry=Adc_ReadGroup
        Adc_ReadGroupSampleResult: implemented-entry=Adc_ReadGroupSampleResult
        Adc_SetClockMode: implemented-entry=Adc_SetClockMode
        Adc_SetCTU2CmdListHandlerCtrlRegs: implemented-entry=Adc_SetCTU2CmdListHandlerCtrlRegs
        Adc_SetCTU2TriggerCompareRegs: implemented-entry=Adc_SetCTU2TriggerCompareRegs
        Adc_SetCTU2TriggerHandlerCtrlRegs: implemented-entry=Adc_SetCTU2TriggerHandlerCtrlRegs
        Adc_SetMode: implemented-entry=Adc_SetMode
        Adc_SetupResultBuffer: implemented-entry=Adc_SetupResultBuffer
        Adc_StartGroupConversion: implemented-entry=Adc_StartGroupConversion
        Adc_StopGroupConversion: implemented-entry=Adc_StopGroupConversion
        Adc_WDGThresholdHandler: implemented-entry=Adc_WDGThresholdHandler
      6 x bsw interrupt entity, all with interrupt-category=CAT-2, interrupt-source=Hardware:
        Adc_DMAEndGroupConvUnit0: implemented-entry=Adc_DMAEndGroupConvUnit0
        Adc_DMAEndGroupConvUnit1: implemented-entry=Adc_DMAEndGroupConvUnit1
        Adc_EndGroupConvUnit0: implemented-entry=Adc_EndGroupConvUnit0
        Adc_EndGroupConvUnit1: implemented-entry=Adc_EndGroupConvUnit1
        Adc_WatchDogThresholdUnit0: implemented-entry=Adc_WatchDogThresholdUnit0
        Adc_WatchDogThresholdUnit1: implemented-entry=Adc_WatchDogThresholdUnit1
package /AUTOSAR_Adc/BswModuleEntrys
  49 x bsw module entry, all with sw-service-impl-policy=STANDARD:
    Adc_BCtuSetMode: service-id=0, is-reentrant=false, is-synchronous=true, call-type=REGULAR, execution-context=UNSPECIFIED
    Adc_BCtuStartSoftwareTrigger: service-id=0, is-reentrant=false, is-synchronous=true, call-type=REGULAR, execution-context=UNSPECIFIED
    Adc_ConfigureThreshold: service-id=0, is-reentrant=false, is-synchronous=true, call-type=REGULAR, execution-context=UNSPECIFIED
    Adc_CTU2TriggerHandlerCtrlRegsEnableDisable: service-id=0, is-reentrant=false, is-synchronous=true, call-type=REGULAR, execution-context=UNSPECIFIED
    Adc_DeInit: service-id=0x01, is-reentrant=false, is-synchronous=true, call-type=REGULAR, execution-context=UNSPECIFIED
    Adc_DisableChannel: service-id=0, is-reentrant=false, is-synchronous=true, call-type=REGULAR, execution-context=UNSPECIFIED
    Adc_DisableCtuTrigger: service-id=0, is-reentrant=false, is-synchronous=true, call-type=REGULAR, execution-context=UNSPECIFIED
    Adc_DisableGroupNotification: service-id=0x08, is-reentrant=true, is-synchronous=true, call-type=REGULAR, execution-context=UNSPECIFIED
    Adc_DisableHardwareTrigger: service-id=0x06, is-reentrant=true, is-synchronous=true, call-type=REGULAR, execution-context=UNSPECIFIED
    Adc_DMAEndGroupConversion: service-id=0, is-reentrant=false, is-synchronous=true, call-type=REGULAR, execution-context=UNSPECIFIED
    Adc_DMAEndInjectedConv: service-id=0, is-reentrant=false, is-synchronous=true, call-type=REGULAR, execution-context=UNSPECIFIED
    Adc_DMAEndNormalConv: service-id=0, is-reentrant=false, is-synchronous=true, call-type=REGULAR, execution-context=UNSPECIFIED
    Adc_EnableChannel: service-id=0, is-reentrant=false, is-synchronous=true, call-type=REGULAR, execution-context=UNSPECIFIED
    Adc_EnableCtuTrigger: service-id=0, is-reentrant=false, is-synchronous=true, call-type=REGULAR, execution-context=UNSPECIFIED
    Adc_EnableGroupNotification: service-id=0x07, is-reentrant=true, is-synchronous=true, call-type=REGULAR, execution-context=UNSPECIFIED
    Adc_EnableHardwareTrigger: service-id=0x05, is-reentrant=true, is-synchronous=true, call-type=REGULAR, execution-context=UNSPECIFIED
    Adc_EndCTUConv: service-id=0, is-reentrant=false, is-synchronous=true, call-type=REGULAR, execution-context=UNSPECIFIED
    Adc_EndGroupConversion: service-id=0, is-reentrant=false, is-synchronous=true, call-type=REGULAR, execution-context=UNSPECIFIED
    Adc_EndInjectedConv: service-id=0, is-reentrant=false, is-synchronous=true, call-type=REGULAR, execution-context=UNSPECIFIED
    Adc_EndMultipleCTUConv: service-id=0, is-reentrant=false, is-synchronous=true, call-type=REGULAR, execution-context=UNSPECIFIED
    Adc_EndNormalConv: service-id=0, is-reentrant=false, is-synchronous=true, call-type=REGULAR, execution-context=UNSPECIFIED
    Adc_EndSwInjectedConv: service-id=0, is-reentrant=false, is-synchronous=true, call-type=REGULAR, execution-context=UNSPECIFIED
    Adc_EndWDGInterrupt: service-id=0, is-reentrant=false, is-synchronous=true, call-type=REGULAR, execution-context=UNSPECIFIED
    Adc_GetCTU2DmaLastSampleIndex: service-id=0, is-reentrant=false, is-synchronous=true, call-type=REGULAR, execution-context=UNSPECIFIED
    Adc_GetGroupStatus: service-id=0x09, is-reentrant=true, is-synchronous=true, call-type=REGULAR, execution-context=UNSPECIFIED
    Adc_GetInjectedConversionStatus: service-id=0, is-reentrant=false, is-synchronous=true, call-type=REGULAR, execution-context=UNSPECIFIED
    Adc_GetStreamLastPointer: service-id=0x0b, is-reentrant=true, is-synchronous=true, call-type=REGULAR, execution-context=UNSPECIFIED
    Adc_GetVersionInfo: service-id=0x0a, is-reentrant=true, is-synchronous=true, call-type=REGULAR, execution-context=UNSPECIFIED
    Adc_GroupGetLastSamples: service-id=0, is-reentrant=false, is-synchronous=true, call-type=REGULAR, execution-context=UNSPECIFIED
    Adc_GroupUpdateNumberSamples: service-id=0, is-reentrant=false, is-synchronous=true, call-type=REGULAR, execution-context=UNSPECIFIED
    Adc_HwResultReadGroup: service-id=0, is-reentrant=false, is-synchronous=true, call-type=REGULAR, execution-context=UNSPECIFIED
    Adc_Init: service-id=0x00, is-reentrant=false, is-synchronous=true, call-type=REGULAR, execution-context=UNSPECIFIED
    Adc_ReadGroup: service-id=0x04, is-reentrant=true, is-synchronous=true, call-type=REGULAR, execution-context=UNSPECIFIED
    Adc_ReadGroupSampleResult: service-id=0, is-reentrant=false, is-synchronous=true, call-type=REGULAR, execution-context=UNSPECIFIED
    Adc_SetClockMode: service-id=0, is-reentrant=false, is-synchronous=true, call-type=REGULAR, execution-context=UNSPECIFIED
    Adc_SetCTU2CmdListHandlerCtrlRegs: service-id=0, is-reentrant=false, is-synchronous=true, call-type=REGULAR, execution-context=UNSPECIFIED
    Adc_SetCTU2TriggerCompareRegs: service-id=0, is-reentrant=false, is-synchronous=true, call-type=REGULAR, execution-context=UNSPECIFIED
    Adc_SetCTU2TriggerHandlerCtrlRegs: service-id=0, is-reentrant=false, is-synchronous=true, call-type=REGULAR, execution-context=UNSPECIFIED
    Adc_SetMode: service-id=0, is-reentrant=false, is-synchronous=true, call-type=REGULAR, execution-context=UNSPECIFIED
    Adc_SetupResultBuffer: service-id=0x0c, is-reentrant=true, is-synchronous=true, call-type=REGULAR, execution-context=UNSPECIFIED
    Adc_StartGroupConversion: service-id=0x02, is-reentrant=true, is-synchronous=false, call-type=REGULAR, execution-context=UNSPECIFIED
    Adc_StopGroupConversion: service-id=0x03, is-reentrant=true, is-synchronous=true, call-type=REGULAR, execution-context=UNSPECIFIED
    Adc_WDGThresholdHandler: service-id=0, is-reentrant=false, is-synchronous=true, call-type=REGULAR, execution-context=UNSPECIFIED
    Adc_DMAEndGroupConvUnit0: service-id=0, is-reentrant=false, is-synchronous=true, call-type=INTERRUPT, execution-context=INTERRUPT-CAT-2
    Adc_DMAEndGroupConvUnit1: service-id=0, is-reentrant=false, is-synchronous=true, call-type=INTERRUPT, execution-context=INTERRUPT-CAT-2
    Adc_EndGroupConvUnit0: service-id=0, is-reentrant=false, is-synchronous=true, call-type=INTERRUPT, execution-context=INTERRUPT-CAT-2
    Adc_EndGroupConvUnit1: service-id=0, is-reentrant=false, is-synchronous=true, call-type=INTERRUPT, execution-context=INTERRUPT-CAT-2
    Adc_WatchDogThresholdUnit0: service-id=0, is-reentrant=false, is-synchronous=true, call-type=INTERRUPT, execution-context=INTERRUPT-CAT-2
    Adc_WatchDogThresholdUnit1: service-id=0, is-reentrant=false, is-synchronous=true, call-type=INTERRUPT, execution-context=INTERRUPT-CAT-2
package /Adc_T2D13M10I1R0/Implementations
  bsw implementation BswImplementation_Adc: programming-language=C, sw-version=1.0.1, vendor-id=43, ar-release-version=4.0.3, behavior=InternalBehavior_Adc, vendor-specific-module-def=Adc
    code-descriptors:
      code Files
        artifact-descriptors:
          short-label=config::Adc.xdm, category=SWCFG
          short-label=doc::AUTOSAR_MCAL_ADC_IM.pdf, category=SWDOC
          short-label=doc::AUTOSAR_MCAL_ADC_UM.pdf, category=SWDOC
          short-label=include::Adc.h, category=SWHDR
          short-label=include::Adc_ADCDig_LLD.h, category=SWHDR
          short-label=include::Adc_ADCDig_LLD_CfgEx.h, category=SWHDR
          short-label=include::Adc_CTU_LLD.h, category=SWHDR
          short-label=include::Adc_LLD.h, category=SWHDR
          short-label=include::Adc_NonASR.h, category=SWHDR
          short-label=include::Dma_LLD.h, category=SWHDR
          short-label=include::Reg_eSys_ADCDig.h, category=SWHDR
          short-label=include::Reg_eSys_CTU.h, category=SWHDR
          short-label=include::Reg_eSys_DMA.h, category=SWHDR
          short-label=src::Adc.c, category=SWSRC
          short-label=src::Adc_ADCDig_LLD.c, category=SWSRC
          short-label=src::Adc_CTU_LLD.c, category=SWSRC
          short-label=src::Adc_Dma_LLD.c, category=SWSRC
          short-label=src::Adc_Irq.c, category=SWSRC
          short-label=src::Adc_LLD.c, category=SWSRC
          short-label=src::Adc_NonASR.c, category=SWSRC
          short-label=src::Reg_eSys_ADCDig.c, category=SWSRC
    4 x compiler:
      CW_Compiler:
        name=CodeWarrior for MPC5xxx
        options=-proc Zen -lang c -opt all -common off -sdatathreshold 0 -sdata2threshold 0 -vle -use_lmw_stmw on -ppc_asm_to_vle -Cpp_exceptions off -func_align 4 -sym dwarf-2,full -gdwarf-2 -w on -r -w undefmacro -char unsigned -nosyspath -fp none -DAUTOSAR_OS_NOT_USED -DMWERKS
        vendor=Freescale Semiconductor
        version=Freescale CodeWarrior for MPC5xxx v2.10 - compiler Version 4.3 build 224
      HT_Compiler: name=Hi-Tech C Compiler, options=-Os -msdata=eabi -G1000 -fshort-double -mno-spe -mregnames -g3 -Wall -mvle --mcpu=z425n3 -DAUTOSAR_OS_NOT_USED -DUSE_SW_VECTOR_MODE, vendor=HiTech, version=HighTec v4.6.4.0, Compiler gcc v4.6.3
      DIAB_Compiler:
        name=Windriver Diab
        options=-Xdialect-ansi -XO -g -Xsize-opt -Xsmall-data=0 -Xaddr-sconst=0x11 -Xaddr-sdata=0x11 -Xno-common -Xnested-interrupts -Xdebug-dwarf2 -Xdebug-local-all -Xdebug-local-cie -Xdebug-struct-all -Xforce-declarations -ee1481 -Xmacro-undefined-warn -W:as:,-l -Wa,-Xisa-vle -DAUTOSAR_OS_NOT_USED -DDIAB -Xforce-prototypes -tPPCE200Z0VEN:simple
        vendor=Windriver
        version=Windriver DIAB Rel DIAB_5_9_2_0-FCS_20120725_234511
      GHS_Compiler: name=Green Hills, options=-cpu=ppc560xb -ansi -noSPE -Ospace -sda=0 -vle -dual_debug -G --no_exceptions -Wundef -Wimplicit-int -Wshadow -Wtrigraphs --prototype_errors --incorrect_pragma_warnings -noslashcomment -preprocess_assembly_files --short_enum --no_commons -c -DAUTOSAR_OS_NOT_USED -DUSE_SW_VECTOR_MODE -DDISABLE_MCAL_INTERMODULE_ASR_CHECK -DGHS, vendor=Green Hills, version=Green Hills MULTI v6.1.4
    generated-artifacts:
      4 x dependency on artifact, all with usages=COMPILE:
        Adc_PBcfg_c: artifact-descriptor={short-label=generate_PB::src::Adc_PBcfg.c, category=SWSRC}
        Adc_Cfg_h: artifact-descriptor={short-label=generate_PC::include::Adc_Cfg.h, category=SWHDR}
        Adc_CTU_ipversion_h: artifact-descriptor={short-label=generate_PC::include::Adc_CTU_ipversion.h, category=SWHDR}
        Adc_Cfg_c: artifact-descriptor={short-label=generate_PC::src::Adc_Cfg.c, category=SWSRC}
    4 x linker:
      CW_Linker: name=CodeWarrior for MPC5xxx, options=-proc Zen -code_merging all -far_near_addressing -vle_enhance_merging -listdwarf -sym dwarf-2,full -char unsigned, vendor=Freescale Semiconductor, version=Freescale CodeWarrior for MPC5xxx v2.10 - compiler Version 4.3 build 224
      HT_Linker: name=Hi-Tech C Compiler, options=-N --no-undefined --warn-common --error-unresolved-symbols -nocrt0 -nostartfiles -Wl --no-warn-flags -T, vendor=HiTech, version=HighTec v4.6.4.0, Compiler gcc v4.6.3
      DIAB_Linker: name=Windriver Diab, options=-tPPCE200Z0VEN:simple -Xelf -m6 -lc -Xlibc-old, vendor=Windriver, version=Windriver DIAB Rel DIAB_5_9_2_0-FCS_20120725_234511
      GHS_Linker: name=Green Hills, options=-cpu=ppc560xb -nostartfiles -vle -linker_warnings, vendor=Green Hills, version=Green Hills MULTI v6.1.4
    resource consumption ResourceConsumption
      5 x memory section:
        ADC_CODE: alignment=UNSPECIFIED, sw-addrmethod=CODE, symbol=CODE
        ADC_CONFIG_DATA_UNSPECIFIED: alignment=UNSPECIFIED, sw-addrmethod=CONFIG_DATA_UNSPECIFIED, symbol=CONFIG_DATA_UNSPECIFIED
        ADC_CONST_32: alignment=32, sw-addrmethod=CONST_32, symbol=CONST_32
        ADC_VAR_INIT_UNSPECIFIED: alignment=UNSPECIFIED, sw-addrmethod=VAR_INIT_UNSPECIFIED, symbol=VAR_INIT_UNSPECIFIED
        ADC_VAR_NO_INIT_UNSPECIFIED: alignment=UNSPECIFIED, sw-addrmethod=VAR_NO_INIT_UNSPECIFIED, symbol=VAR_NO_INIT_UNSPECIFIED
