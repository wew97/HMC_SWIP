AUTOSAR XML (schema 4-0-3)
package /CanTp_BswMDT
  bsw implementation BswImplementation_CanTp: sw-version=1.0.5, vendor-id=76, ar-release-version=4.0.3, behavior=BswInternalBehavior_0
  bsw module description CanTp: module-id=35
    bsw internal behavior BswInternalBehavior_0
      exclusive area TIMER_PROTECTION
      bsw schedulable entity BswSE_CanTp_MainFunction: can-enter-exclusive-area=TIMER_PROTECTION, implemented-entry=CanTp_MainFunction
      bsw timing event BswTE_CanTp_MainFunction: starts-on-event=BswSE_CanTp_MainFunction, period=0.005
  bsw module entry CanTp_MainFunction: service-id=6, is-reentrant=false, is-synchronous=false, call-type=SCHEDULED, execution-context=TASK, sw-service-impl-policy=STANDARD
