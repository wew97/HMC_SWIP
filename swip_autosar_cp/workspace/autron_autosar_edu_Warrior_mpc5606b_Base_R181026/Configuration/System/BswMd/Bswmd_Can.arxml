AUTOSAR XML (schema 4-0-3)
package /AUTOSAR_Can/BswModuleDescriptions
  bsw module description Can: module-id=80
    provided-entrys:
      Can_AbortMb
      Can_ChangeBaudrate
      Can_CheckBaudrate
      Can_CheckWakeup
      Can_DisableControllerInterrupts
      Can_EnableControllerInterrupts
      Can_GetVersionInfo
      Can_Init
      Can_SetClockMode
      Can_SetControllerMode
      Can_Write
    bsw internal behavior InternalBehavior_Can
      7 x exclusive area:
        CAN_EXCLUSIVE_AREA_{00..06}
      11 x bsw called entity:
        Can_AbortMb: implemented-entry=Can_AbortMb
        Can_ChangeBaudrate: implemented-entry=Can_ChangeBaudrate
        Can_CheckBaudrate: implemented-entry=Can_CheckBaudrate
        Can_CheckWakeup: implemented-entry=Can_CheckWakeup
        Can_DisableControllerInterrupts: implemented-entry=Can_DisableControllerInterrupts
        Can_EnableControllerInterrupts: implemented-entry=Can_EnableControllerInterrupts
        Can_GetVersionInfo: implemented-entry=Can_GetVersionInfo
        Can_Init: can-enter-exclusive-area=[CAN_EXCLUSIVE_AREA_00, CAN_EXCLUSIVE_AREA_01, CAN_EXCLUSIVE_AREA_02, CAN_EXCLUSIVE_AREA_03, CAN_EXCLUSIVE_AREA_04, CAN_EXCLUSIVE_AREA_05, CAN_EXCLUSIVE_AREA_06], implemented-entry=Can_Init
        Can_SetClockMode: implemented-entry=Can_SetClockMode
        Can_SetControllerMode: implemented-entry=Can_SetControllerMode
        Can_Write: implemented-entry=Can_Write
package /AUTOSAR_Can/BswModuleEntrys
  11 x bsw module entry, all with call-type=REGULAR, execution-context=UNSPECIFIED, sw-service-impl-policy=STANDARD:
    Can_AbortMb: service-id=0, is-reentrant=false, is-synchronous=true
    Can_ChangeBaudrate: service-id=0x0d, is-reentrant=false, is-synchronous=true
    Can_CheckBaudrate: service-id=0x0e, is-reentrant=true, is-synchronous=true
    Can_CheckWakeup: service-id=0x0b, is-reentrant=false, is-synchronous=true
    Can_DisableControllerInterrupts: service-id=0x04, is-reentrant=true, is-synchronous=true
    Can_EnableControllerInterrupts: service-id=0x05, is-reentrant=true, is-synchronous=true
    Can_GetVersionInfo: service-id=0x07, is-reentrant=true, is-synchronous=true
    Can_Init: service-id=0x00, is-reentrant=false, is-synchronous=true
    Can_SetClockMode: service-id=0, is-reentrant=false, is-synchronous=true
    Can_SetControllerMode: service-id=0x03, is-reentrant=false, is-synchronous=false
    Can_Write: service-id=0x06, is-reentrant=true, is-synchronous=true
package /Can_T2D13M10I1R0/Implementations
  bsw implementation BswImplementation_Can: programming-language=C, sw-version=1.0.1, vendor-id=43, ar-release-version=4.0.3, behavior=InternalBehavior_Can, vendor-specific-module-def=Can
    code-descriptors:
      code Files
        artifact-descriptors:
          short-label=config::Can.xdm, category=SWCFG
          short-label=doc::AUTOSAR_MCAL_CAN_IM.pdf, category=SWDOC
          short-label=doc::AUTOSAR_MCAL_CAN_UM.pdf, category=SWDOC
          short-label=include::Can.h, category=SWHDR
          short-label=include::Can_FlexCan_LLD.h, category=SWHDR
          short-label=include::Can_LLD.h, category=SWHDR
          short-label=include::Reg_eSys_FlexCan.h, category=SWHDR
          short-label=src::Can.c, category=SWSRC
          short-label=src::Can_FlexCan_LLD.c, category=SWSRC
          short-label=src::Can_Irq.c, category=SWSRC
          short-label=src::Can_LLD.c, category=SWSRC
    4 x compiler:
      CW_Compiler:
        name=CodeWarrior for MPC5xxx
        options=-proc Zen -lang c -opt all -common off -sdatathreshold 0 -sdata2threshold 0 -vle -use_lmw_stmw on -ppc_asm_to_vle -Cpp_exceptions off -func_align 4 -sym dwarf-2,full -gdwarf-2 -w on -r -w undefmacro -char unsigned -nosyspath -fp none -DAUTOSAR_OS_NOT_USED -DMWERKS
        vendor=Freescale Semiconductor
        version=Freescale CodeWarrior for MPC5xxx v2.10 - compiler Version 4.3 build 224
      HT_Compiler: name=Hi-Tech C Compiler, options=-Os -msdata=eabi -G1000 -fshort-double -mno-spe -mregnames -g3 -Wall -mvle --mcpu=z425n3 -DAUTOSAR_OS_NOT_USED -DUSE_SW_VECTOR_MODE, vendor=HiTech, version=HighTec v4.6.4.0, Compiler gcc v4.6.3
      DIAB_Compiler:
        name=Windriver Diab
        options=-Xdialect-ansi -XO -g -Xsize-opt -Xsmall-data=0 -Xaddr-sconst=0x11 -Xaddr-sdata=0x11 -Xno-common -Xnested-interrupts -Xdebug-dwarf2 -Xdebug-local-all -Xdebug-local-cie -Xdebug-struct-all -Xforce-declarations -ee1481 -Xmacro-undefined-warn -W:as:,-l -Wa,-Xisa-vle -DAUTOSAR_OS_NOT_USED -DDIAB -Xforce-prototypes -tPPCE200Z0VEN:simple
        vendor=Windriver
        version=Windriver DIAB Rel DIAB_5_9_2_0-FCS_20120725_234511
      GHS_Compiler: name=Green Hills, options=-cpu=ppc560xb -ansi -noSPE -Ospace -sda=0 -vle -dual_debug -G --no_exceptions -Wundef -Wimplicit-int -Wshadow -Wtrigraphs --prototype_errors --incorrect_pragma_warnings -noslashcomment -preprocess_assembly_files --short_enum --no_commons -c -DAUTOSAR_OS_NOT_USED -DUSE_SW_VECTOR_MODE -DDISABLE_MCAL_INTERMODULE_ASR_CHECK -DGHS, vendor=Green Hills, version=Green Hills MULTI v6.1.4
    generated-artifacts:
      dependency on artifact Can_PBcfg_c: artifact-descriptor={short-label=generate_PB::src::Can_PBcfg.c, category=SWSRC}, usages=COMPILE
      dependency on artifact Can_Cfg_h: artifact-descriptor={short-label=generate_PC::include::Can_Cfg.h, category=SWHDR}, usages=COMPILE
      dependency on artifact Can_Cfg_c: artifact-descriptor={short-label=generate_PC::src::Can_Cfg.c, category=SWSRC}, usages=COMPILE
    4 x linker:
      CW_Linker: name=CodeWarrior for MPC5xxx, options=-proc Zen -code_merging all -far_near_addressing -vle_enhance_merging -listdwarf -sym dwarf-2,full -char unsigned, vendor=Freescale Semiconductor, version=Freescale CodeWarrior for MPC5xxx v2.10 - compiler Version 4.3 build 224
      HT_Linker: name=Hi-Tech C Compiler, options=-N --no-undefined --warn-common --error-unresolved-symbols -nocrt0 -nostartfiles -Wl --no-warn-flags -T, vendor=HiTech, version=HighTec v4.6.4.0, Compiler gcc v4.6.3
      DIAB_Linker: name=Windriver Diab, options=-tPPCE200Z0VEN:simple -Xelf -m6 -lc -Xlibc-old, vendor=Windriver, version=Windriver DIAB Rel DIAB_5_9_2_0-FCS_20120725_234511
      GHS_Linker: name=Green Hills, options=-cpu=ppc560xb -nostartfiles -vle -linker_warnings, vendor=Green Hills, version=Green Hills MULTI v6.1.4
    resource consumption ResourceConsumption
      7 x memory section:
        CAN_CODE: alignment=UNSPECIFIED, sw-addrmethod=CODE, symbol=CODE
        CAN_CONFIG_DATA_UNSPECIFIED: alignment=UNSPECIFIED, sw-addrmethod=CONFIG_DATA_UNSPECIFIED, symbol=CONFIG_DATA_UNSPECIFIED
        CAN_CONST_UNSPECIFIED: alignment=UNSPECIFIED, sw-addrmethod=CONST_UNSPECIFIED, symbol=CONST_UNSPECIFIED
        CAN_RAMCODE: alignment=UNSPECIFIED, sw-addrmethod=RAMCODE, symbol=RAMCODE
        CAN_VAR_INIT_UNSPECIFIED: alignment=UNSPECIFIED, sw-addrmethod=VAR_INIT_UNSPECIFIED, symbol=VAR_INIT_UNSPECIFIED
        CAN_VAR_NO_INIT_32: alignment=32, sw-addrmethod=VAR_NO_INIT_32, symbol=VAR_NO_INIT_32
        CAN_VAR_NO_INIT_UNSPECIFIED: alignment=UNSPECIFIED, sw-addrmethod=VAR_NO_INIT_UNSPECIFIED, symbol=VAR_NO_INIT_UNSPECIFIED
