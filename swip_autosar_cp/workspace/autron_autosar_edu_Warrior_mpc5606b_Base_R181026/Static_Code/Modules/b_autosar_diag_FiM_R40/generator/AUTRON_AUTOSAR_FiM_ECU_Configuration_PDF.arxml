AUTOSAR XML (schema 4-0-3)
# (C) 2013 HYUNDAI AUTRON Co., Ltd.
# Confidential Proprietary Information. Distribution Limited.
# Do Not Copy Without Prior Permission
package /AUTRON
  ecuc definition collection ParameterDefinition_FiM: module=FiM
  module definition FiM: refined-module-def=FiM, variants pre-compile  # Configuration of the FiM (Function Inhibition Manager) module.
    container FiMConfigSet  # This container contains the configuration parameters and sub containers of the FiM module supporting multiple configuration sets. | This container is a MultipleConfigurationContainer, i.e. this container and its sub-containers exist once per configuration set.
      container FiMEventSummary [0..*]  # The summarized EventId definition record consists of a summarized event ID and a specific EventId. | This record means that a particular FID that has to be disabled in case of summarized event (defined above) is to be disabled in any of the specific events. A possible solution could be assigning events as summarized events along with a list of specific events. During the configuration process the summarized event substitutes the referenced single events.However, it is not outlined how this requirement is solved - whether by configuration process or by implementation within the FiM. The FiM configuration tool could also build up a suitable data structure for summarized events and deal with it in the FiM implementation.
        symbolic name reference FiMInputSumEventRef [1..*]: set at pre-compile, destination=DemEventParameter  # This reference parameter points to the Dem Event parameter, grouping events together to form a summarized event.
        symbolic name reference FiMOutputSumEventRef: set at pre-compile, destination=FiMSummaryEventId  # This reference parameter points to FiMSummaryEventId identifying the grouped Dem events as unique IDs
      container FiMFID [0..*]  # This container includes symbolic names of all FIDs.
        integer FiMFunctionId: 0..65535, set at pre-compile, symbolic-name-value=true  # The configuration parameter is used as an ID which represents a functionality. FiMFunctionId is the unique identifier assigned during FIM configuration. | Implementation Type: FiM_FunctionIdType.
      container FiMInhibitionConfiguration [0..*]  # This container includes all configuration parameters concerning the relationship between event and FID.
        enumeration FiMInhInhibitionMask: {FIM_LAST_FAILED, FIM_NOT_TESTED, FIM_TESTED, FIM_TESTED_AND_FAILED}, set at pre-compile  # The configuration parameter is used to specify the inhibition mask for an event - FID relation. | Specifies relation between event and FID FIM_LAST_FAILED : Last Failed - DEM_UDS_STATUS_TF flag of Dem Eventstatus is set Use case:Re-configuration, avoiding follow-up errors FIM_NOT_TESTED : Not Tested this cycle - DEM_UDS_STATUS_TNCTOC flag of Dem Eventstatus is set. Use case: Scheduling of monitors. FIM_TESTED : Tested - DEM_UDS_STATUS_TNCTOC flag of Dem Eventstatus is not set. Use case: Self deactivation, check during driving cycle. FIM_TESTED_AND_FAILED : Tested and Failed - DEM_UDS_STATUS_TF flag of Dem Eventstatus is set and DEM_UDS_STATUS_TNCTOC flag is not set Use case: Avoiding deadlocks, repeated monitoring.
        reference FiMInhFunctionIdRef: set at pre-compile, destination=FiMFID  # This parameter gives reference to the Function Id indicating event-Fid link
        container FiMInhEventId  # The configuration parameter is used for an existing DEM event and summarized events as well.
          choice container FiMInhRefChoice
            container FiMInhChoiceDemRef [0..1]
              symbolic name reference FiMInhEventRef: set at pre-compile, destination=DemEventParameter  # This parameter gives reference to the Dem event parameter to fetch the event id linked.
            container FiMInhChoiceSumRef [0..1]
              symbolic name reference FiMInhSumRef [1..*]: set at pre-compile, destination=FiMSummaryEventId  # This parameter gives reference to FiMSummaryEventId to fetch the summary id linked.
      container FiMSummaryEventId [0..*]  # This container defines the name of a summarized event.
        integer FiMEventSumId: 0..65535, set at pre-compile, symbolic-name-value=true  # The summarized EventId definition record defines the existence of a summarized event with a specific name. This summarized event can be referenced in the EventSummary (as FimSummaryEventId) and Inhibition configuration (as FimInhEventId).
    container FiMGeneral  # This container contains the general configuration parameters of FiM module.
      boolean FiMDataFixed: category=NOT_SUPPORTED, set at pre-compile  # Enables or disables calibration of inhibit relations The scope of the parameter is to meet the requirement (FIM008) to have the option to calibrate inhibit data on the one hand side and also to provide the option to protect inhibit data for consistency reasons. | true: enables calibration of inhibit relations. false: disables calibration of inhibit relations.
      boolean FiMDevErrorDetect: category=FIXED, set at pre-compile  # This configuration parameter is used to switch on or to switch off the detection of development errors during development. | true: enables the detection of development errors during development. false: disables the detection of development errors during development.
      boolean FiMEventUpdateTriggeredByDem: category=FIXED, set at pre-compile  # This configuration parameter specifies the way FIM obtains status of EventIds. | true: DEM informs FIM about changes of event status, false: FIM polls event status from the DEM module either cyclically or on demand.
      integer FiMMaxEventFidLinks: 1..65535, set at pre-compile  # This configuration parameter specifies the total maximum number of links between EventIds and FIDs.
      integer FiMMaxEventsPerFid: 1..65535, set at pre-compile  # This configuration parameter specifies the maximum number of EventIds that can be linked to a single FID.
      integer FiMMaxFidsPerEvent: 1..65535, set at pre-compile  # This configuration parameter specifies the maximum number of FIDs that can be linked to a single event.
      integer FiMMaxSummaryEvents: 0..65535, set at pre-compile  # This configuration parameter specifies the maximum number of summarized events that can be configured.
      integer FiMMaxSummaryLinks: 0..65535, set at pre-compile  # This configuration parameter specifies the total maximum number of links between EventIds and summarized events.
      integer FiMMaxTotalLinks: 1..65535, set at pre-compile  # This configuration parameter specifies the total maximum number of links between EventIds and FIDs plus the number of links between EventIds and summarized events.
      float FiMTaskTime: 0..0.1, category=FIXED, set at pre-compile  # Allow to configure the time for the periodic cyclic task. Please note: This configuration value shall be equal to the value in the Basic Software Scheduler configuration of the RTE module. | The AUTOSAR configuration standard is to use SI units, so this parameter is defined as float value in seconds. Dem configuration tools must convert this float value to the appropriate value format for the use in the software implementation of Dem. min:A negative value is not allowed. max:FID must be set after a maximal time of 100ms after Dem status is set. upperMultiplicity:Exactly one TaskTime must be specified per configuration. lowerMultiplicity:Exactly one TaskTime must be specified per configuration.
      boolean FiMVersionInfoApi: category=FIXED, set at pre-compile  # This configuration parameter is used to switch on or to switch off the API to get the version information. | true: enables the version Api info false: disables the version Api info
