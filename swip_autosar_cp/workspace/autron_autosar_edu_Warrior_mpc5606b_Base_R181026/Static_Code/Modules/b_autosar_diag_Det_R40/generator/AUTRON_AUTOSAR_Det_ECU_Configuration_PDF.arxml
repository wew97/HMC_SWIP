AUTOSAR XML (schema 4-0-3)
# (C) 2013 HYUNDAI AUTRON Co., Ltd.
# Confidential Proprietary Information. Distribution Limited.
# Do Not Copy Without Prior Permission
package /AUTRON
  ecuc definition collection ParameterDefinition_Det: module=Det
  module definition Det: refined-module-def=Det, variants pre-compile  # Det configuration includes the functions to be called at notification. | On one side the application functions are specified and in general it can be decided whether Dlt shall be called at each call of Det.
    container DetGeneral  # Generic configuration parameters of the Det module.
      boolean DetForwardToDlt [0..1]: set at pre-compile, default-value=false  # Only if the parameter is present and set to true, the Det requires the Dlt interface and forwards it's call to the function Dlt_DetForwardErrorTrace. In this case the optional interface to Dlt_Det is required. | true: Det requires Dlt interface. false: Det does not require Dlt interface.
      boolean DetVersionInfoApi: set at pre-compile, default-value=false  # Pre-processor switch to enable / disable the API to read out the modules version information. | true: Version info API enabled. false: Version info API disabled.
      integer DetRamBufferSize [0..1]: 1..65535, set at pre-compile, origin=AUTRON_v1.0.1, default-value=1  # This parameter specifies RAM buffer size.
    container DetNotification [0..1]  # Configuration of the notification functions.
      function name DetErrorHook [0..*]: set at pre-compile  # Optional list of functions to be called by the Development Error Tracer in context of each call of Det_ReportError. | The type of these functions shall be identical the type of Det_ReportError itself: Std_ReturnType (*f)(uint16, uint8, uint8, uint8).
