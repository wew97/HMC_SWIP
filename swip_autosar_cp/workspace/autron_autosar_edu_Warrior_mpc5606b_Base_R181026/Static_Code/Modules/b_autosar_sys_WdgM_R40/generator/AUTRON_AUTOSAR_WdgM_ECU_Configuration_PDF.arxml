AUTOSAR XML (schema 4-0-3)
# (C) 2014 HYUNDAI AUTRON Co., Ltd.
# Confidential Proprietary Information. Distribution Limited.
# Do Not Copy Without Prior Permission
package /AUTRON
  module definition WdgM: refined-module-def=WdgM, variants pre-compile  # Configuration of the WdgM (Watchdog Manager) module.
    container WdgMConfigSet  # This container describes one of multiple configuration sets of WdgM. | This is a MultipleConfigurationContainer, i.e. this container and its sub-containers exist once per configuration set.
      integer WdgMDeInitTimeout [0..1]: 1..65535, set at pre-compile, origin=AUTRON, symbolic-name-value=true, default-value=1  # This parameter shall contain the value that is passed to WdgIf_SetTriggerCondition for WdgM_DeInit process.
      symbolic name reference WdgMInitialMode: set at pre-compile, destination=WdgMMode  # The mode that the Watchdog Manager is in after it has been initialized.
      container WdgMDemEventParameterRefs [0..1]: category=FIXED  # Container for the references to DemEventParameter elements which shall be invoked using the API Dem_ReportErrorStatus API in case the corresponding error occurs. The EventId is taken from the referenced DemEventParameter's DemEventId value. The standardized errors are provided in the container and can be extended by vendor specific error references.
        symbolic name reference WDGM_E_IMPROPER_CALLER [0..1]: category=FIXED, set at pre-compile, destination=DemEventParameter  # Reference to the DemEventParameter which shall be issued when the defensive behavior checks have detected an improper caller.
        symbolic name reference WDGM_E_MONITORING [0..1]: category=FIXED, set at pre-compile, destination=DemEventParameter  # Reference to the DemEventParameter which shall be issued when the error "Monitoring has failed and a watchdog reset will occur" has occured.
        symbolic name reference WDGM_E_SET_MODE [0..1]: category=FIXED, set at pre-compile, destination=DemEventParameter  # Reference to the DemEventParameter which shall be issued when the error "Watchdog drivers' mode switch has failed" has occured.
      container WdgMMode [1..255]  # The container describes one of several modes of the Watchdog Manager.
        integer WdgMExpiredSupervisionCycleTol: 0..65535, set at pre-compile  # This parameter shall be used to define a value that fixes the amount of expired supervision cycles for how long the blocking of watchdog triggering shall be postponed, AFTER THE GLOBAL SUPERVISION STATUS HAS REACHED THE STATE EXPIRED.
        integer WdgMModeId: 0..255, set at pre-compile, symbolic-name-value=true  # This parameter fixes the identfier for the mode. This identifier is for instance passed as a parameter to the WdgM_SetMode service.
        float WdgMSupervisionCycle: 0..65.535, set at pre-compile  # This parameter defines the schedule period of the main function WdgM_MainFunction. | Unit: [s]
        container WdgMAliveSupervision [0..65535]  # This container collects all configuration parameters of Alive-Supervision of one Checkpoint. Note that each Checkpoint may have different parameters. For example, it may have different min and max margin.
          integer WdgMExpectedAliveIndications: 0..65535, set at pre-compile  # This parameter contains the amount of expected alive indications of the Checkpoint within the referenced amount of defined supervision cycles according to corresponding SE.
          integer WdgMMaxMargin: 0..255, set at pre-compile  # This parameter contains the amount of alive indications of the Checkpoint that are acceptable to be additional to the expected alive indications within the corresponding supervision reference cycle.
          integer WdgMMinMargin: 0..255, set at pre-compile  # This parameter contains the amount of alive indications of the Checkpoint that are acceptable to be missed from the expected alive indications within the corresponding supervision reference cycle.
          integer WdgMSupervisionReferenceCycle: 1..65535, set at pre-compile  # This parameter shall contain the amount of supervision cycles to be used as reference by the alive-supervision mechanism to perform the checkup with counted alive indications according to corresponding SE.
          symbolic name reference WdgMAliveSupervisionCheckpointRef: set at pre-compile, destination=WdgMCheckpoint  # Reference to Checkpoint within a Supervised Entity that shall be supervised.
        container WdgMDeadlineSupervision [0..65535]  # This container collects all configuration parameters for Deadline Supervision for a Supervised Entity.
          float WdgMDeadlineMax: 0..65.535, set at pre-compile  # This parameter contains the longest time span after which the deadline is considered to be met. | Unit: [s]
          float WdgMDeadlineMin: 0..65.535, set at pre-compile  # This parameter contains the shortest time span after which the deadline is considered to be met. | Unit: [s]
          symbolic name reference WdgMDeadlineStartRef: set at pre-compile, destination=WdgMCheckpoint  # This is the reference to the start Checkpoint for Deadline Supervision.
          symbolic name reference WdgMDeadlineStopRef: set at pre-compile, destination=WdgMCheckpoint  # This is the reference to the stop Checkpoint for Deadline Supervision.
        container WdgMExternalLogicalSupervision [0..65535]  # This container collects all configuration parameters for Logical Supervision for one external graph.
          symbolic name reference WdgMExternalCheckpointFinalRef [1..65535]: set at pre-compile, destination=WdgMCheckpoint  # This is the reference to the final Checkpoint(s) for this External Graph.
          symbolic name reference WdgMExternalCheckpointInitialRef [1..65535]: set at pre-compile, destination=WdgMCheckpoint  # This is the reference to the initial Checkpoint(s) for this External Graph.
          container WdgMExternalTransition [0..65535]  # This container collects the Checkpoints for an External Transition across Supervised Entities.
            symbolic name reference WdgMExternalTransitionDestRef: set at pre-compile, destination=WdgMCheckpoint  # This is the reference to the destination Checkpoint of an External Transition.
            symbolic name reference WdgMExternalTransitionSourceRef: set at pre-compile, destination=WdgMCheckpoint  # This is the reference to the source Checkpoint of an External Transition.
        container WdgMLocalStatusParams [0..65535]  # This container collects all configuration parameters for the Local Status of a Supervised Entity.
          integer WdgMFailedAliveSupervisionRefCycleTol: 0..255, set at pre-compile  # This parameter shall contain the acceptable amount of reference cycles with incorrect/failed alive supervisions for this Supervised Entity.
          symbolic name reference WdgMLocalStatusSupervisedEntityRef: set at pre-compile, destination=WdgMSupervisedEntity  # This is the reference to the Supervised Entity for which the Local Status parameters are specified.
        container WdgMTrigger [0..255]  # This container collects all configuration parameters for the triggering of hardware watchdogs.
          integer WdgMTriggerConditionValue: 1..65535, set at pre-compile  # This parameter shall contain the value that is passed to WdgIf_SetTriggerCondition for this watchdog.
          enumeration WdgMWatchdogMode: {WDGIF_FAST_MODE, WDGIF_OFF_MODE, WDGIF_SLOW_MODE}, set at pre-compile  # This parameter contains the watchdog mode that shall be used for the referenced watchdog in this Watchdog Manager mode. | Implementation Type: WdgIf_ModeType
          symbolic name reference WdgMTriggerWatchdogRef: set at pre-compile, destination=WdgMWatchdog  # This parameter is a reference to the configured watchdog.
    container WdgMGeneral  # Container defines all general configuration parameters of the Watchdog Manager.
      boolean WdgMDefensiveBehavior: category=FIXED, set at pre-compile, default-value=false  # Preprocessor switch to enable/disable the defensive behavior of the Watchdog Manager module. | true: Preprocessor switch to enable the defensive behavior of the Watchdog Manager module false: Preprocessor switch to disable the defensive behavior of the Watchdog Manager module.
      boolean WdgMDemStoppedSupervisionReport: category=FIXED, set at pre-compile  # Parameter to enable/disable the error reporting to DEM. true: A notification to DEM is sent if the Watchdog Manager reaches the state WDGM_GLOBAL_STATUS_STOPPED. false: The notification is disabled. | true: Enable the error reporting to DEM false: Disable the error reporting to DEM.
      boolean WdgMDevErrorDetect: category=FIXED, set at pre-compile  # Preprocessor switch to enable/disable development error detection and reporting. Shall be used to remove unneeded code segments regarding DET features true: Development error detection is enabled false: Development error detection is disabled. | true: Enable the development error detection and reporting false: Disable the development error detection and reporting.
      boolean WdgMImmediateReset: category=FIXED, set at pre-compile  # This parameter enables/disablse the immediate reset feature in case of alive-supervision failure. true: Immediate reset is enabled false: Immediate reset is disabled. | true: Enable the immediate reset feature in case of alive-supervision failure false: Disable the immediate reset feature in case of alive-supervision failure.
      boolean WdgMOffModeEnabled: category=FIXED, set at pre-compile  # This parameter enables/disables the selection of the "OffMode" of the watchdog driver.true: "OffMode" selection is allowed false: "OffMode" selection is disallowed. | true: Enable the selection of the "OffMode" of the watchdog driver false: Disable the selection of the "OffMode" of the watchdog driver.
      boolean WdgMVersionInfoApi: category=FIXED, set at pre-compile  # Preprocessor switch to enable/disable the existence of the API WdgM_GetVersionInfo. Shall be used to remove unneeded code segments. true: API is enabled false: API is disabled. | true: Enable the version info API false: Disable the version info API.
      enumeration WdgMOsVendor: {AUTRON_OS, FREESCALE_OS, RENESAS_OS}, category=FIXED, origin=AUTRON
      boolean WdgMErrorInfoApi: category=NOT_SUPPORTED, set at pre-compile, origin=AUTRON  # Preprocessor switch to enable/disable the existence of the API WdgM_GetErrorInfo. Shall be used to remove unneeded code segments. true: API is enabled false: API is disabled. | true: Enable the version info API false: Disable the version info API.
      container WdgMCallerIds [0..1]  # Contains the definition of valid CallerIds for the callers who have permission to call the function WdgM_SetMode.
        integer WdgMCallerId [1..255]: 0..65535, set at pre-compile  # This parameter defines one valid CallerId for the callers who have permission to call the function WdgM_SetMode.
      container WdgMSupervisedEntity [0..65535]  # This container collects all common (mode-independent) parameters of a Supervised Entity to be supervised by the Watchdog Manager.
        integer WdgMSupervisedEntityId: 0..65535, set at pre-compile, symbolic-name-value=true  # This parameter shall contain the unique identifier of the supervised entity.
        reference WdgMEcucPartitionRef [0..1]: category=NOT_SUPPORTED, set at pre-compile, destination=EcucPartition  # Denotes in which "EcucPartition" the supervised entity is executed. When the partition is stopped, the supervised entity shall be de-activated in the WdgM to avoid an ECU reset.
        reference WdgMOsApplicationRef [0..1]: category=NOT_SUPPORTED, set at pre-compile, destination=OsApplication  # Optional reference to an OS Application. Beware, the Watchdog Manager module will trigger a partition restart of this OS Application when the corresponding Supervised Entity reaches WDGM_LOCAL_STATUS_FAILED.
        symbolic name reference WdgMInternalCheckpointInitialRef: set at pre-compile, destination=WdgMCheckpoint  # This is the reference to the initial Checkpoint for this Supervised Entity.
        symbolic name reference WdgMInternalCheckpointFinalRef [1..65535]: set at pre-compile, destination=WdgMCheckpoint  # This is the reference to the final Checkpoint(s) for this Supervised Entity.
        reference WdgMOsCounter [0..1]: set at pre-compile, origin=AUTRON, destination=OsCounter  # OS counter used by Watchdog Manager to perform the deadline monitoring of the Supervised Entity.
        container WdgMCheckpoint [1..65535]  # This container collects all Checkpoints of this Supervised Entity. Each Supervised Entity has at least one Checkpoint.
          integer WdgMCheckpointId: 0..65535, set at pre-compile, symbolic-name-value=true  # This parameter shall contain the unique identifier of Checkpoint.
        container WdgMInternalTransition [0..65535]  # This container defines the graph of Internal Transitions within this Supervised Entity.
          symbolic name reference WdgMInternalTransitionDestRef: set at pre-compile, destination=WdgMCheckpoint  # This is the reference to the destination Checkpoint of a Internal Transition within this Supervised Entity.
          symbolic name reference WdgMInternalTransitionSourceRef: set at pre-compile, destination=WdgMCheckpoint  # This is the reference to the source Checkpoint of a Internal Transition within this Supervised Entity.
      container WdgMWatchdog [0..255]: category=FIXED  # This container collects all common (mode-independent) parameters of a Watchdog to be triggered by the Watchdog Manager.
        string WdgMWatchdogName: category=FIXED, set at pre-compile, symbolic-name-value=true  # This parameter shall contain the symbolic name of the watchdog instance.
        symbolic name reference WdgMWatchdogDeviceRef: category=FIXED, set at pre-compile, destination=WdgIfDevice  # Reference to one device container of Watchdog Interface. In the referenced container WdgIfDevice, the parameter WdgIfDeviceIndex contains the Index parameter that WdgM has to use for WdgIf_SetTriggerCondition calls for that watchdog instance.
  ecuc definition collection ParameterDefinition_WdgM: module=WdgM
